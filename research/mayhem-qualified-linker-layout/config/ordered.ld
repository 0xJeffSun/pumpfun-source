
PHDRS
{
  text PT_LOAD ;
  rodata PT_LOAD ;
  data PT_LOAD ;
  dynamic PT_DYNAMIC ;
}

SECTIONS
{
  . = SIZEOF_HEADERS;
  .text : {
    *mayhem_recovered.mayhem_recovered.5873b11261813b4b-cgu.0.rcgu.o(".text._ZN103_$LT$anchor_lang..accounts..interface..Interface$LT$T$GT$$u20$as$u20$anchor_lang..Accounts$LT$B$GT$$GT$12try_accounts17h3d26edd0b076e72cE")
    *mayhem_recovered.mayhem_recovered.5873b11261813b4b-cgu.0.rcgu.o(".text._ZN106_$LT$curve_accounts..account_wrapper..AccountWrapper$LT$T$GT$$u20$as$u20$anchor_lang..AccountSerialize$GT$13try_serialize17hc6fd9384cadce3dfE")
    *mayhem_recovered.mayhem_recovered.5873b11261813b4b-cgu.0.rcgu.o(".text._ZN97_$LT$mayhem_recovered..instructions..sell..SellCurve$u20$as$u20$anchor_lang..AccountSerialize$GT$13try_serialize17h7bcde09485a1c9eeE")
    *mayhem_recovered.mayhem_recovered.5873b11261813b4b-cgu.0.rcgu.o(".text.unlikely._ZN16mayhem_recovered15account_wrapper109_$LT$impl$u20$anchor_lang..AccountDeserialize$u20$for$u20$mayhem_recovered..instructions..sell..SellCurve$GT$25try_deserialize_unchecked17h07336fd3992c91bfE")
    *mayhem_recovered.mayhem_recovered.5873b11261813b4b-cgu.0.rcgu.o(".text.unlikely._ZN108_$LT$curve_accounts..account_wrapper..AccountWrapper$LT$T$GT$$u20$as$u20$anchor_lang..AccountDeserialize$GT$25try_deserialize_unchecked17h8731421955d39cc5E")
    *mayhem_recovered.mayhem_recovered.5873b11261813b4b-cgu.0.rcgu.o(".text._ZN111_$LT$alloc..vec..Vec$LT$T$GT$$u20$as$u20$alloc..vec..spec_from_iter_nested..SpecFromIterNested$LT$T$C$I$GT$$GT$9from_iter17h1f7019011485e6c6E")
    *mayhem_recovered.mayhem_recovered.5873b11261813b4b-cgu.0.rcgu.o(".text._ZN118_$LT$anchor_lang..accounts..interface_account..InterfaceAccount$LT$T$GT$$u20$as$u20$anchor_lang..Accounts$LT$B$GT$$GT$12try_accounts17h0c588caa11e4998aE")
    *mayhem_recovered.mayhem_recovered.5873b11261813b4b-cgu.0.rcgu.o(".text._ZN118_$LT$anchor_lang..accounts..interface_account..InterfaceAccount$LT$T$GT$$u20$as$u20$anchor_lang..Accounts$LT$B$GT$$GT$12try_accounts17h05f67b2e2b6625c1E")
    *mayhem_recovered.mayhem_recovered.5873b11261813b4b-cgu.0.rcgu.o(".text._ZN11anchor_lang5error5Error11with_values17ha61c8de13817389aE")
    *mayhem_recovered.mayhem_recovered.5873b11261813b4b-cgu.0.rcgu.o(".text._ZN11anchor_lang5error5Error11with_values17h9abf310c3427864dE")
    *mayhem_recovered.mayhem_recovered.5873b11261813b4b-cgu.0.rcgu.o(".text._ZN11anchor_lang5error5Error17with_account_name17h0484b17c3fdd072aE")
    *mayhem_recovered.mayhem_recovered.5873b11261813b4b-cgu.0.rcgu.o(".text._ZN11anchor_lang5error5Error17with_account_name17heac630c63e63c52eE")
    *mayhem_recovered.mayhem_recovered.5873b11261813b4b-cgu.0.rcgu.o(".text._ZN11anchor_lang8accounts17interface_account25InterfaceAccount$LT$T$GT$18try_from_unchecked17hbabd5d954714acdaE")
    *mayhem_recovered.mayhem_recovered.5873b11261813b4b-cgu.0.rcgu.o(".text._ZN11anchor_lang8accounts17interface_account25InterfaceAccount$LT$T$GT$6reload17hb74a4e7aa634f1b6E")
    *mayhem_recovered.mayhem_recovered.5873b11261813b4b-cgu.0.rcgu.o(".text._ZN11anchor_lang8accounts17interface_account25InterfaceAccount$LT$T$GT$8try_from17he531392ad0f18401E")
    *mayhem_recovered.mayhem_recovered.5873b11261813b4b-cgu.0.rcgu.o(".text._ZN11anchor_lang8accounts5boxed87_$LT$impl$u20$anchor_lang..Accounts$LT$B$GT$$u20$for$u20$alloc..boxed..Box$LT$T$GT$$GT$12try_accounts17hcb37762a80530a76E")
    *mayhem_recovered.mayhem_recovered.5873b11261813b4b-cgu.0.rcgu.o(".text._ZN11anchor_lang8accounts5boxed87_$LT$impl$u20$anchor_lang..Accounts$LT$B$GT$$u20$for$u20$alloc..boxed..Box$LT$T$GT$$GT$12try_accounts17h57ed44ea19bb88c4E")
    *mayhem_recovered.mayhem_recovered.5873b11261813b4b-cgu.0.rcgu.o(".text._ZN11anchor_lang8accounts5boxed87_$LT$impl$u20$anchor_lang..Accounts$LT$B$GT$$u20$for$u20$alloc..boxed..Box$LT$T$GT$$GT$12try_accounts17h7e64a5edbe9266cbE")
    *mayhem_recovered.mayhem_recovered.5873b11261813b4b-cgu.0.rcgu.o(".text._ZN11anchor_lang8accounts5boxed87_$LT$impl$u20$anchor_lang..Accounts$LT$B$GT$$u20$for$u20$alloc..boxed..Box$LT$T$GT$$GT$12try_accounts17h0ed631e9cde30dfdE")
    *mayhem_recovered.mayhem_recovered.5873b11261813b4b-cgu.0.rcgu.o(".text._ZN11anchor_lang8accounts5boxed87_$LT$impl$u20$anchor_lang..Accounts$LT$B$GT$$u20$for$u20$alloc..boxed..Box$LT$T$GT$$GT$12try_accounts17h4cc24dd41fc3eefcE")
    *mayhem_recovered.mayhem_recovered.5873b11261813b4b-cgu.0.rcgu.o(".text._ZN11anchor_lang8accounts5boxed87_$LT$impl$u20$anchor_lang..Accounts$LT$B$GT$$u20$for$u20$alloc..boxed..Box$LT$T$GT$$GT$12try_accounts17h1aa45dc2074efb3cE")
    *mayhem_recovered.mayhem_recovered.5873b11261813b4b-cgu.0.rcgu.o(".text._ZN11anchor_lang8accounts7account16Account$LT$T$GT$18try_from_unchecked17h5a342db38e654fc4E")
    *mayhem_recovered.mayhem_recovered.5873b11261813b4b-cgu.0.rcgu.o(".text._ZN11anchor_lang8accounts7account16Account$LT$T$GT$18try_from_unchecked17h300916e35962cac8E")
    *mayhem_recovered.mayhem_recovered.5873b11261813b4b-cgu.0.rcgu.o(".text._ZN11anchor_lang8accounts7account16Account$LT$T$GT$18try_from_unchecked17h10643e83a5f5cec4E")
    *mayhem_recovered.mayhem_recovered.5873b11261813b4b-cgu.0.rcgu.o(".text._ZN11anchor_lang8accounts7account16Account$LT$T$GT$24exit_with_expected_owner17hb31617fdb4da14f4E")
    *mayhem_recovered.mayhem_recovered.5873b11261813b4b-cgu.0.rcgu.o(".text._ZN11anchor_lang8accounts7account16Account$LT$T$GT$6reload17h23d426093dc4d6ccE")
    *mayhem_recovered.mayhem_recovered.5873b11261813b4b-cgu.0.rcgu.o(".text._ZN11anchor_lang8accounts7account16Account$LT$T$GT$8try_from17hf2e4001f6e2453feE")
    *mayhem_recovered.mayhem_recovered.5873b11261813b4b-cgu.0.rcgu.o(".text._ZN11anchor_lang8accounts7account16Account$LT$T$GT$8try_from17h10bda417b9e29b92E")
    *mayhem_recovered.mayhem_recovered.5873b11261813b4b-cgu.0.rcgu.o(".text._ZN11anchor_lang8accounts7account16Account$LT$T$GT$8try_from17h7666b0e873653796E")
    *mayhem_recovered.mayhem_recovered.5873b11261813b4b-cgu.0.rcgu.o(".text._ZN11anchor_lang8accounts7account16Account$LT$T$GT$8try_from17h6e7fb91e4998c5b4E")
    *mayhem_recovered.mayhem_recovered.5873b11261813b4b-cgu.0.rcgu.o(".text._ZN11anchor_lang8accounts7account16Account$LT$T$GT$8try_from17h3411ded62acc2300E")
    *mayhem_recovered.mayhem_recovered.5873b11261813b4b-cgu.0.rcgu.o(".text._ZN11anchor_lang8accounts7account16Account$LT$T$GT$8try_from17h78902bb3c877b751E")
    *mayhem_recovered.mayhem_recovered.5873b11261813b4b-cgu.0.rcgu.o(".text._ZN11anchor_lang8accounts7account16Account$LT$T$GT$8try_from17h44558d3a78e0f415E")
    *mayhem_recovered.mayhem_recovered.5873b11261813b4b-cgu.0.rcgu.o(".text._ZN139_$LT$anchor_lang..accounts..interface..Interface$LT$T$GT$$u20$as$u20$core..convert..TryFrom$LT$$RF$solana_account_info..AccountInfo$GT$$GT$8try_from17h6e0987422bdfc031E")
    *mayhem_recovered.mayhem_recovered.5873b11261813b4b-cgu.0.rcgu.o(".text._ZN42_$LT$$RF$T$u20$as$u20$core..fmt..Debug$GT$3fmt17h210f0b10749b1c3aE")
    *mayhem_recovered.mayhem_recovered.5873b11261813b4b-cgu.0.rcgu.o(".text._ZN42_$LT$$RF$T$u20$as$u20$core..fmt..Debug$GT$3fmt17h343de3ead5028c5dE")
    *mayhem_recovered.mayhem_recovered.5873b11261813b4b-cgu.0.rcgu.o(".text._ZN4core3fmt3num49_$LT$impl$u20$core..fmt..Debug$u20$for$u20$u8$GT$3fmt17habfbb78acd9b5468E")
    *mayhem_recovered.mayhem_recovered.5873b11261813b4b-cgu.0.rcgu.o(".text._ZN4core3fmt5Write9write_fmt17hc5d4f24c95c133fcE")
    *mayhem_recovered.mayhem_recovered.5873b11261813b4b-cgu.0.rcgu.o(".text._ZN4core3ptr42drop_in_place$LT$alloc..string..String$GT$17h9c1cc3999596d9deE")
    *mayhem_recovered.mayhem_recovered.5873b11261813b4b-cgu.0.rcgu.o(".text._ZN4core3ptr53drop_in_place$LT$solana_account_info..AccountInfo$GT$17ha5fb963ce38a1033E")
    *mayhem_recovered.mayhem_recovered.5873b11261813b4b-cgu.0.rcgu.o(".text._ZN4core3ptr74drop_in_place$LT$$u5b$solana_account_info..AccountInfo$u3b$$u20$1$u5d$$GT$17h632e06a0e4b509caE")
    *mayhem_recovered.mayhem_recovered.5873b11261813b4b-cgu.0.rcgu.o(".text._ZN4core3ptr76drop_in_place$LT$alloc..vec..Vec$LT$solana_account_info..AccountInfo$GT$$GT$17h33a78a69fdd9d26bE")
    *mayhem_recovered.mayhem_recovered.5873b11261813b4b-cgu.0.rcgu.o(".text._ZN4core4hash11BuildHasher8hash_one17hb0ceb0e59aab3cfcE")
    *mayhem_recovered.mayhem_recovered.5873b11261813b4b-cgu.0.rcgu.o(".text._ZN52_$LT$bool$u20$as$u20$borsh..de..BorshDeserialize$GT$18deserialize_reader17h959be35975df3141E")
    *mayhem_recovered.mayhem_recovered.5873b11261813b4b-cgu.0.rcgu.o(".text._ZN53_$LT$core..fmt..Error$u20$as$u20$core..fmt..Debug$GT$3fmt17haaa5bdc6ce3ebfafE")
    *mayhem_recovered.mayhem_recovered.5873b11261813b4b-cgu.0.rcgu.o(".text._ZN58_$LT$alloc..string..String$u20$as$u20$core..fmt..Write$GT$10write_char17h6537f18e3aa683b6E")
    *mayhem_recovered.mayhem_recovered.5873b11261813b4b-cgu.0.rcgu.o(".text._ZN58_$LT$alloc..string..String$u20$as$u20$core..fmt..Write$GT$9write_str17hca2d36081997e77fE")
    *mayhem_recovered.mayhem_recovered.5873b11261813b4b-cgu.0.rcgu.o(".text.unlikely._ZN5alloc7raw_vec11finish_grow17hbec7dcb11d3b6ba9E")
    *mayhem_recovered.mayhem_recovered.5873b11261813b4b-cgu.0.rcgu.o(".text.unlikely._ZN5alloc7raw_vec20RawVecInner$LT$A$GT$7reserve21do_reserve_and_handle17h4e9173e881c3d868E")
    *mayhem_recovered.mayhem_recovered.5873b11261813b4b-cgu.0.rcgu.o(".text._ZN70_$LT$core..num..error..TryFromIntError$u20$as$u20$core..fmt..Debug$GT$3fmt17hac919583bbb90a47E")
    *mayhem_recovered.mayhem_recovered.5873b11261813b4b-cgu.0.rcgu.o(".text._ZN71_$LT$solana_account_info..AccountInfo$u20$as$u20$core..clone..Clone$GT$5clone17hd4841c21abb7ce01E")
    *mayhem_recovered.mayhem_recovered.5873b11261813b4b-cgu.0.rcgu.o(".text._ZN71_$LT$solana_address..Address$u20$as$u20$borsh..de..BorshDeserialize$GT$18deserialize_reader17h26e8b36710bf24f2E")
    *mayhem_recovered.mayhem_recovered.5873b11261813b4b-cgu.0.rcgu.o(".text._ZN71_$LT$solana_program_error..ProgramError$u20$as$u20$core..fmt..Debug$GT$3fmt17h6c1b6a595146bf75E")
    *mayhem_recovered.mayhem_recovered.5873b11261813b4b-cgu.0.rcgu.o(".text._ZN77_$LT$core..option..Option$LT$T$GT$$u20$as$u20$borsh..de..BorshDeserialize$GT$18deserialize_reader17ha75498467169cf0dE")
    *mayhem_recovered.mayhem_recovered.5873b11261813b4b-cgu.0.rcgu.o(".text._ZN77_$LT$core..option..Option$LT$T$GT$$u20$as$u20$borsh..de..BorshDeserialize$GT$18deserialize_reader17ha6a800bd8c5491d7E")
    *mayhem_recovered.mayhem_recovered.5873b11261813b4b-cgu.0.rcgu.o(".text._ZN88_$LT$anchor_lang..accounts..signer..Signer$u20$as$u20$anchor_lang..Accounts$LT$B$GT$$GT$12try_accounts17h16cccddefc612698E")
    *mayhem_recovered.mayhem_recovered.5873b11261813b4b-cgu.0.rcgu.o(".text._ZN99_$LT$anchor_lang..accounts..account..Account$LT$T$GT$$u20$as$u20$anchor_lang..Accounts$LT$B$GT$$GT$12try_accounts17h219f02f7bcc0dac8E")
    *mayhem_recovered.mayhem_recovered.5873b11261813b4b-cgu.0.rcgu.o(".text._ZN99_$LT$anchor_lang..accounts..account..Account$LT$T$GT$$u20$as$u20$anchor_lang..Accounts$LT$B$GT$$GT$12try_accounts17h0f4f3d6741a3df65E")
    *mayhem_recovered.mayhem_recovered.5873b11261813b4b-cgu.0.rcgu.o(".text._ZN99_$LT$anchor_lang..accounts..account..Account$LT$T$GT$$u20$as$u20$anchor_lang..Accounts$LT$B$GT$$GT$12try_accounts17hb65ee181760f9f8bE")
    *mayhem_recovered.mayhem_recovered.5873b11261813b4b-cgu.0.rcgu.o(".text._ZN99_$LT$anchor_lang..accounts..account..Account$LT$T$GT$$u20$as$u20$anchor_lang..Accounts$LT$B$GT$$GT$12try_accounts17hb1ddfe5f984d51cbE")
    *mayhem_recovered.mayhem_recovered.5873b11261813b4b-cgu.0.rcgu.o(".text._ZN99_$LT$anchor_lang..accounts..account..Account$LT$T$GT$$u20$as$u20$anchor_lang..Accounts$LT$B$GT$$GT$12try_accounts17h2d895f75b5df1119E")
    *mayhem_recovered.mayhem_recovered.5873b11261813b4b-cgu.0.rcgu.o(".text._ZN99_$LT$anchor_lang..accounts..account..Account$LT$T$GT$$u20$as$u20$anchor_lang..Accounts$LT$B$GT$$GT$12try_accounts17h32368d117f5e4bdfE")
    *mayhem_recovered.mayhem_recovered.5873b11261813b4b-cgu.0.rcgu.o(".text._ZN99_$LT$anchor_lang..accounts..program..Program$LT$T$GT$$u20$as$u20$anchor_lang..Accounts$LT$B$GT$$GT$12try_accounts17h19a0495368064e30E")
    *mayhem_recovered.mayhem_recovered.5873b11261813b4b-cgu.0.rcgu.o(".text._ZN99_$LT$anchor_lang..accounts..program..Program$LT$T$GT$$u20$as$u20$anchor_lang..Accounts$LT$B$GT$$GT$12try_accounts17h6de8a3f70652cf38E")
    *mayhem_recovered.mayhem_recovered.5873b11261813b4b-cgu.0.rcgu.o(".text._ZN99_$LT$anchor_lang..accounts..program..Program$LT$T$GT$$u20$as$u20$anchor_lang..Accounts$LT$B$GT$$GT$12try_accounts17h2a4cb06366f30903E")
    *mayhem_recovered.mayhem_recovered.5873b11261813b4b-cgu.0.rcgu.o(".text._ZN99_$LT$anchor_lang..accounts..program..Program$LT$T$GT$$u20$as$u20$anchor_lang..Accounts$LT$B$GT$$GT$12try_accounts17h01e657355b703b11E")
    *mayhem_recovered.mayhem_recovered.5873b11261813b4b-cgu.0.rcgu.o(".text._ZN9hashbrown3map28HashMap$LT$K$C$V$C$S$C$A$GT$6insert17hc0a7979c76d0f269E")
    *mayhem_recovered.mayhem_recovered.5873b11261813b4b-cgu.0.rcgu.o(".text.unlikely._ZN9hashbrown3raw21RawTable$LT$T$C$A$GT$14reserve_rehash17hf23f629f8f05b4dfE")
    *mayhem_recovered.mayhem_recovered.5873b11261813b4b-cgu.0.rcgu.o(".text._ZN16mayhem_recovered16mayhem_recovered14withdraw_admin17h8885ca9db2443c29E")
    *mayhem_recovered.mayhem_recovered.5873b11261813b4b-cgu.0.rcgu.o(".text._ZN16mayhem_recovered16mayhem_recovered20withdraw_quote_admin17h184e9cdd75bd66ecE")
    *mayhem_recovered.mayhem_recovered.5873b11261813b4b-cgu.0.rcgu.o(".text._ZN16mayhem_recovered16mayhem_recovered20update_global_params17h83a7bfcfa4e67b22E")
    *mayhem_recovered.mayhem_recovered.5873b11261813b4b-cgu.0.rcgu.o(".text._ZN16mayhem_recovered12instructions4burn7handler17h2d792565683f6167E")
    *mayhem_recovered.mayhem_recovered.5873b11261813b4b-cgu.0.rcgu.o(".text._ZN16mayhem_recovered12instructions14extend_account7handler17h063ca14a4240bcbcE")
    *mayhem_recovered.mayhem_recovered.5873b11261813b4b-cgu.0.rcgu.o(".text._ZN16mayhem_recovered12instructions14fee_recipients12FeeRecipient14validate_sweep17hdb45755804b0e931E")
    *mayhem_recovered.mayhem_recovered.5873b11261813b4b-cgu.0.rcgu.o(".text._ZN16mayhem_recovered12instructions14fee_recipients10initialize17h37a48c4d07eaf253E")
    *mayhem_recovered.mayhem_recovered.5873b11261813b4b-cgu.0.rcgu.o(".text._ZN16mayhem_recovered16mayhem_recovered16sweep_fees_admin17h316b2bdecf902fd7E")
    *mayhem_recovered.mayhem_recovered.5873b11261813b4b-cgu.0.rcgu.o(".text._ZN16mayhem_recovered16mayhem_recovered10sweep_fees17ha4ec56c51eb3e228E")
    *mayhem_recovered.mayhem_recovered.5873b11261813b4b-cgu.0.rcgu.o(".text._ZN16mayhem_recovered12instructions13buy_pump_swap7handler17he3e5f90cfe00fd78E")
    *mayhem_recovered.mayhem_recovered.5873b11261813b4b-cgu.0.rcgu.o(".text._ZN16mayhem_recovered12instructions18pump_amm_interface14buy_cpi_failed17h59ce9477dc24845fE")
    *mayhem_recovered.mayhem_recovered.5873b11261813b4b-cgu.0.rcgu.o(".text._ZN16mayhem_recovered12instructions14sell_pump_swap7handler17h3f6e33f24353f41fE")
    *mayhem_recovered.mayhem_recovered.5873b11261813b4b-cgu.0.rcgu.o(".text._ZN16mayhem_recovered12instructions18pump_amm_interface15sell_cpi_failed17h44d523568b51ad78E")
    *mayhem_recovered.mayhem_recovered.5873b11261813b4b-cgu.0.rcgu.o(".text._ZN16mayhem_recovered12instructions3buy7handler17hfc64bc1d60511cc9E")
    *mayhem_recovered.mayhem_recovered.5873b11261813b4b-cgu.0.rcgu.o(".text._ZN16mayhem_recovered12instructions4sell7handler17hdf3b68c7bd710049E")
    *mayhem_recovered.mayhem_recovered.5873b11261813b4b-cgu.0.rcgu.o(".text._ZN16mayhem_recovered12instructions6buy_v27handler17h862680a1551ff4a0E")
    *mayhem_recovered.mayhem_recovered.5873b11261813b4b-cgu.0.rcgu.o(".text._ZN16mayhem_recovered12instructions7sell_v27handler17h686a43f3b0055947E")
    *mayhem_recovered.mayhem_recovered.5873b11261813b4b-cgu.0.rcgu.o(".text._ZN16mayhem_recovered5state12GlobalParams24validate_native_withdraw17had8fcb9709a76655E")
    *mayhem_recovered.mayhem_recovered.5873b11261813b4b-cgu.0.rcgu.o(".text._ZN16mayhem_recovered5state12GlobalParams23validate_quote_withdraw17h14c634205306c1e8E")
    *mayhem_recovered.mayhem_recovered.5873b11261813b4b-cgu.0.rcgu.o(".text._ZN16mayhem_recovered5state12GlobalParams12apply_update17h974f695c3aa87f31E")
    *mayhem_recovered.mayhem_recovered.5873b11261813b4b-cgu.0.rcgu.o(".text._ZN16mayhem_recovered5state12GlobalParams12stop_trading17h2226e705d4a9b930E")
    *mayhem_recovered.mayhem_recovered.5873b11261813b4b-cgu.0.rcgu.o(".text._ZN16mayhem_recovered5state12GlobalParams14resume_trading17h1eb666cfcc0d9db8E")
    *mayhem_recovered.mayhem_recovered.5873b11261813b4b-cgu.0.rcgu.o(".text._ZN16mayhem_recovered5state14record_amm_buy17hd6e685cf8e0a240dE")
    *mayhem_recovered.mayhem_recovered.5873b11261813b4b-cgu.0.rcgu.o(".text._ZN16mayhem_recovered5state11record_sell17h813d3ebb8e0bd9ddE")
    *mayhem_recovered.mayhem_recovered.5873b11261813b4b-cgu.0.rcgu.o(".text._ZN16mayhem_recovered5state9buy_quote17h11b61322b9eeca0eE")
    *mayhem_recovered.mayhem_recovered.5873b11261813b4b-cgu.0.rcgu.o(".text._ZN16mayhem_recovered5state10sell_quote17ha77411139354aab0E")
    *mayhem_recovered.mayhem_recovered.5873b11261813b4b-cgu.0.rcgu.o(".text._ZN16mayhem_recovered5state11MayhemState14validate_trade17he59f1fe93692b46cE")
    *mayhem_recovered.mayhem_recovered.5873b11261813b4b-cgu.0.rcgu.o(".text._ZN16mayhem_recovered5state11MayhemState14validate_quote17h48a22fd0509750afE")
    *mayhem_recovered.mayhem_recovered.5873b11261813b4b-cgu.0.rcgu.o(".text._ZN16mayhem_recovered11MayhemError4name17h6504ce9ba2159d7aE")
    *mayhem_recovered.mayhem_recovered.5873b11261813b4b-cgu.0.rcgu.o(".text._ZN68_$LT$mayhem_recovered..MayhemError$u20$as$u20$core..fmt..Display$GT$3fmt17h2713be01a17656eaE")
    *mayhem_recovered.mayhem_recovered.5873b11261813b4b-cgu.0.rcgu.o(".text._ZN66_$LT$mayhem_recovered..MayhemError$u20$as$u20$core..fmt..Debug$GT$3fmt17hcd5dc954dbf349f8E")
    *mayhem_recovered.mayhem_recovered.5873b11261813b4b-cgu.0.rcgu.o(".text._ZN177_$LT$mayhem_recovered..instructions..admin..InitializeGlobalParams$u20$as$u20$anchor_lang..Accounts$LT$mayhem_recovered..instructions..admin..InitializeGlobalParamsBumps$GT$$GT$12try_accounts17h7783aa7a183f4ad9E")
    *mayhem_recovered.mayhem_recovered.5873b11261813b4b-cgu.0.rcgu.o(".text._ZN177_$LT$mayhem_recovered..instructions..admin..InitializeGlobalParams$u20$as$u20$anchor_lang..Accounts$LT$mayhem_recovered..instructions..admin..InitializeGlobalParamsBumps$GT$$GT$12try_accounts28_$u7b$$u7b$closure$u7d$$u7d$17he5c859b93d549b63E")
    *mayhem_recovered.mayhem_recovered.5873b11261813b4b-cgu.0.rcgu.o(".text._ZN107_$LT$mayhem_recovered..instructions..admin..InitializeGlobalParams$u20$as$u20$anchor_lang..AccountsExit$GT$4exit17hde1878f8455308e8E")
    *mayhem_recovered.mayhem_recovered.5873b11261813b4b-cgu.0.rcgu.o(".text._ZN101_$LT$mayhem_recovered..Admin$u20$as$u20$anchor_lang..Accounts$LT$mayhem_recovered..AdminBumps$GT$$GT$12try_accounts17h88d08100524f4e30E")
    *mayhem_recovered.mayhem_recovered.5873b11261813b4b-cgu.0.rcgu.o(".text._ZN69_$LT$mayhem_recovered..Admin$u20$as$u20$anchor_lang..AccountsExit$GT$4exit17h48c3825c767784b0E")
    *mayhem_recovered.mayhem_recovered.5873b11261813b4b-cgu.0.rcgu.o(".text._ZN117_$LT$mayhem_recovered..WithdrawAdmin$u20$as$u20$anchor_lang..Accounts$LT$mayhem_recovered..WithdrawAdminBumps$GT$$GT$12try_accounts17h073dd3d8071dcf02E")
    *mayhem_recovered.mayhem_recovered.5873b11261813b4b-cgu.0.rcgu.o(".text._ZN77_$LT$mayhem_recovered..WithdrawAdmin$u20$as$u20$anchor_lang..AccountsExit$GT$4exit17h50ab93085bd5c9c2E")
    *mayhem_recovered.mayhem_recovered.5873b11261813b4b-cgu.0.rcgu.o(".text._ZN127_$LT$mayhem_recovered..WithdrawQuoteAdmin$u20$as$u20$anchor_lang..Accounts$LT$mayhem_recovered..WithdrawQuoteAdminBumps$GT$$GT$12try_accounts17hac37f8465e5309b9E")
    *mayhem_recovered.mayhem_recovered.5873b11261813b4b-cgu.0.rcgu.o(".text._ZN127_$LT$mayhem_recovered..WithdrawQuoteAdmin$u20$as$u20$anchor_lang..Accounts$LT$mayhem_recovered..WithdrawQuoteAdminBumps$GT$$GT$12try_accounts28_$u7b$$u7b$closure$u7d$$u7d$17h369f24624d30a3fbE")
    *mayhem_recovered.mayhem_recovered.5873b11261813b4b-cgu.0.rcgu.o(".text._ZN82_$LT$mayhem_recovered..WithdrawQuoteAdmin$u20$as$u20$anchor_lang..AccountsExit$GT$4exit17hdef5425b7c9466a0E")
    *mayhem_recovered.mayhem_recovered.5873b11261813b4b-cgu.0.rcgu.o(".text._ZN151_$LT$mayhem_recovered..instructions..burn..BurnTokens$u20$as$u20$anchor_lang..Accounts$LT$mayhem_recovered..instructions..burn..BurnTokensBumps$GT$$GT$12try_accounts17hed2cf931d3f58eaaE")
    *mayhem_recovered.mayhem_recovered.5873b11261813b4b-cgu.0.rcgu.o(".text._ZN94_$LT$mayhem_recovered..instructions..burn..BurnTokens$u20$as$u20$anchor_lang..AccountsExit$GT$4exit17hdc0655dc8aa60606E")
    *mayhem_recovered.mayhem_recovered.5873b11261813b4b-cgu.0.rcgu.o(".text._ZN117_$LT$mayhem_recovered..ExtendAccount$u20$as$u20$anchor_lang..Accounts$LT$mayhem_recovered..ExtendAccountBumps$GT$$GT$12try_accounts17h0c46baea85328ac5E")
    *mayhem_recovered.mayhem_recovered.5873b11261813b4b-cgu.0.rcgu.o(".text._ZN75_$LT$mayhem_recovered..ExtendAccountEvent$u20$as$u20$anchor_lang..Event$GT$4data17h5e9d785f71df67d0E")
    *mayhem_recovered.mayhem_recovered.5873b11261813b4b-cgu.0.rcgu.o(".text._ZN110_$LT$mayhem_recovered..instructions..fee_recipients..FeeRecipient$u20$as$u20$anchor_lang..AccountSerialize$GT$13try_serialize17h39d4015e349b8f9cE")
    *mayhem_recovered.mayhem_recovered.5873b11261813b4b-cgu.0.rcgu.o(".text._ZN112_$LT$mayhem_recovered..instructions..fee_recipients..FeeRecipient$u20$as$u20$anchor_lang..AccountDeserialize$GT$15try_deserialize17h2d5face4f770dc74E")
    *mayhem_recovered.mayhem_recovered.5873b11261813b4b-cgu.0.rcgu.o(".text._ZN112_$LT$mayhem_recovered..instructions..fee_recipients..FeeRecipient$u20$as$u20$anchor_lang..AccountDeserialize$GT$25try_deserialize_unchecked17h810f1dde65418999E")
    *mayhem_recovered.mayhem_recovered.5873b11261813b4b-cgu.0.rcgu.o(".text._ZN195_$LT$mayhem_recovered..instructions..fee_recipients..InitializeFeeRecipient$u20$as$u20$anchor_lang..Accounts$LT$mayhem_recovered..instructions..fee_recipients..InitializeFeeRecipientBumps$GT$$GT$12try_accounts17h6208fb727ad9064fE")
    *mayhem_recovered.mayhem_recovered.5873b11261813b4b-cgu.0.rcgu.o(".text._ZN195_$LT$mayhem_recovered..instructions..fee_recipients..InitializeFeeRecipient$u20$as$u20$anchor_lang..Accounts$LT$mayhem_recovered..instructions..fee_recipients..InitializeFeeRecipientBumps$GT$$GT$12try_accounts28_$u7b$$u7b$closure$u7d$$u7d$17hcc9edcf64db5d64aE")
    *mayhem_recovered.mayhem_recovered.5873b11261813b4b-cgu.0.rcgu.o(".text._ZN195_$LT$mayhem_recovered..instructions..fee_recipients..InitializeFeeRecipient$u20$as$u20$anchor_lang..Accounts$LT$mayhem_recovered..instructions..fee_recipients..InitializeFeeRecipientBumps$GT$$GT$12try_accounts28_$u7b$$u7b$closure$u7d$$u7d$17h560ee9f54f52e580E")
    *mayhem_recovered.mayhem_recovered.5873b11261813b4b-cgu.0.rcgu.o(".text._ZN116_$LT$mayhem_recovered..instructions..fee_recipients..InitializeFeeRecipient$u20$as$u20$anchor_lang..AccountsExit$GT$4exit17h91cc56f3faa6a157E")
    *mayhem_recovered.mayhem_recovered.5873b11261813b4b-cgu.0.rcgu.o(".text._ZN109_$LT$mayhem_recovered..SweepFees$u20$as$u20$anchor_lang..Accounts$LT$mayhem_recovered..SweepFeesBumps$GT$$GT$12try_accounts17h6f56e16abb73b374E")
    *mayhem_recovered.mayhem_recovered.5873b11261813b4b-cgu.0.rcgu.o(".text._ZN73_$LT$mayhem_recovered..SweepFees$u20$as$u20$anchor_lang..AccountsExit$GT$4exit17h921eb1d649ea138fE")
    *mayhem_recovered.mayhem_recovered.5873b11261813b4b-cgu.0.rcgu.o(".text._ZN119_$LT$mayhem_recovered..SweepFeesAdmin$u20$as$u20$anchor_lang..Accounts$LT$mayhem_recovered..SweepFeesAdminBumps$GT$$GT$12try_accounts17h627978f65c96b23dE")
    *mayhem_recovered.mayhem_recovered.5873b11261813b4b-cgu.0.rcgu.o(".text._ZN78_$LT$mayhem_recovered..SweepFeesAdmin$u20$as$u20$anchor_lang..AccountsExit$GT$4exit17hd0f3ae7d26edba8eE")
    *mayhem_recovered.mayhem_recovered.5873b11261813b4b-cgu.0.rcgu.o(".text._ZN171_$LT$mayhem_recovered..instructions..buy_pump_swap..BuyPumpSwap$u20$as$u20$anchor_lang..Accounts$LT$mayhem_recovered..instructions..buy_pump_swap..BuyPumpSwapBumps$GT$$GT$12try_accounts17he8d05787d2fe869dE")
    *mayhem_recovered.mayhem_recovered.5873b11261813b4b-cgu.0.rcgu.o(".text._ZN171_$LT$mayhem_recovered..instructions..buy_pump_swap..BuyPumpSwap$u20$as$u20$anchor_lang..Accounts$LT$mayhem_recovered..instructions..buy_pump_swap..BuyPumpSwapBumps$GT$$GT$12try_accounts28_$u7b$$u7b$closure$u7d$$u7d$17h285281831ff3198fE")
    *mayhem_recovered.mayhem_recovered.5873b11261813b4b-cgu.0.rcgu.o(".text._ZN104_$LT$mayhem_recovered..instructions..buy_pump_swap..BuyPumpSwap$u20$as$u20$anchor_lang..AccountsExit$GT$4exit17h54021c81e15bfb2eE")
    *mayhem_recovered.mayhem_recovered.5873b11261813b4b-cgu.0.rcgu.o(".text._ZN175_$LT$mayhem_recovered..instructions..sell_pump_swap..SellPumpSwap$u20$as$u20$anchor_lang..Accounts$LT$mayhem_recovered..instructions..sell_pump_swap..SellPumpSwapBumps$GT$$GT$12try_accounts17hdd0244d1275e9aaeE")
    *mayhem_recovered.mayhem_recovered.5873b11261813b4b-cgu.0.rcgu.o(".text._ZN106_$LT$mayhem_recovered..instructions..sell_pump_swap..SellPumpSwap$u20$as$u20$anchor_lang..AccountsExit$GT$4exit17h75d7cfe50be7981cE")
    *mayhem_recovered.mayhem_recovered.5873b11261813b4b-cgu.0.rcgu.o(".text._ZN147_$LT$mayhem_recovered..instructions..buy..LegacyBuy$u20$as$u20$anchor_lang..Accounts$LT$mayhem_recovered..instructions..buy..LegacyBuyBumps$GT$$GT$12try_accounts17h1c8d5a6090b85379E")
    *mayhem_recovered.mayhem_recovered.5873b11261813b4b-cgu.0.rcgu.o(".text._ZN92_$LT$mayhem_recovered..instructions..buy..LegacyBuy$u20$as$u20$anchor_lang..AccountsExit$GT$4exit17h0276ca95a3d98f03E")
    *mayhem_recovered.mayhem_recovered.5873b11261813b4b-cgu.0.rcgu.o(".text._ZN151_$LT$mayhem_recovered..instructions..sell..LegacySell$u20$as$u20$anchor_lang..Accounts$LT$mayhem_recovered..instructions..sell..LegacySellBumps$GT$$GT$12try_accounts17heec10a5563f88e04E")
    *mayhem_recovered.mayhem_recovered.5873b11261813b4b-cgu.0.rcgu.o(".text._ZN94_$LT$mayhem_recovered..instructions..sell..LegacySell$u20$as$u20$anchor_lang..AccountsExit$GT$4exit17hfd13a9173c569a7cE")
    *mayhem_recovered.mayhem_recovered.5873b11261813b4b-cgu.0.rcgu.o(".text._ZN96_$LT$mayhem_recovered..instructions..pump_interface..SellEvent$u20$as$u20$anchor_lang..Event$GT$4data17h714acef52920b081E")
    *mayhem_recovered.mayhem_recovered.5873b11261813b4b-cgu.0.rcgu.o(".text._ZN145_$LT$mayhem_recovered..instructions..buy_v2..BuyV2$u20$as$u20$anchor_lang..Accounts$LT$mayhem_recovered..instructions..buy_v2..BuyV2Bumps$GT$$GT$12try_accounts17h33ea4b993f9fdd96E")
    *mayhem_recovered.mayhem_recovered.5873b11261813b4b-cgu.0.rcgu.o(".text._ZN91_$LT$mayhem_recovered..instructions..buy_v2..BuyV2$u20$as$u20$anchor_lang..AccountsExit$GT$4exit17h814e8ff99a80d6eeE")
    *mayhem_recovered.mayhem_recovered.5873b11261813b4b-cgu.0.rcgu.o(".text._ZN149_$LT$mayhem_recovered..instructions..sell_v2..SellV2$u20$as$u20$anchor_lang..Accounts$LT$mayhem_recovered..instructions..sell_v2..SellV2Bumps$GT$$GT$12try_accounts17h43ac8c0a871f7b5fE")
    *mayhem_recovered.mayhem_recovered.5873b11261813b4b-cgu.0.rcgu.o(".text._ZN93_$LT$mayhem_recovered..instructions..sell_v2..SellV2$u20$as$u20$anchor_lang..AccountsExit$GT$4exit17h79661f101003149aE")
    *mayhem_recovered.mayhem_recovered.5873b11261813b4b-cgu.0.rcgu.o(".text._ZN87_$LT$mayhem_recovered..state..GlobalParams$u20$as$u20$anchor_lang..AccountSerialize$GT$13try_serialize17hc703704ab9352f85E")
    *mayhem_recovered.mayhem_recovered.5873b11261813b4b-cgu.0.rcgu.o(".text._ZN89_$LT$mayhem_recovered..state..GlobalParams$u20$as$u20$anchor_lang..AccountDeserialize$GT$15try_deserialize17hd799782c27e8cb28E")
    *mayhem_recovered.mayhem_recovered.5873b11261813b4b-cgu.0.rcgu.o(".text._ZN89_$LT$mayhem_recovered..state..GlobalParams$u20$as$u20$anchor_lang..AccountDeserialize$GT$25try_deserialize_unchecked17h93d07273f5c79203E")
    *mayhem_recovered.mayhem_recovered.5873b11261813b4b-cgu.0.rcgu.o(".text._ZN85_$LT$mayhem_recovered..state..MayhemStatus$u20$as$u20$borsh..de..BorshDeserialize$GT$18deserialize_reader17h34ded3ee368c42cdE")
    *mayhem_recovered.mayhem_recovered.5873b11261813b4b-cgu.0.rcgu.o(".text._ZN86_$LT$mayhem_recovered..state..MayhemState$u20$as$u20$anchor_lang..AccountSerialize$GT$13try_serialize17hb6ae40776d14a893E")
    *mayhem_recovered.mayhem_recovered.5873b11261813b4b-cgu.0.rcgu.o(".text._ZN88_$LT$mayhem_recovered..state..MayhemState$u20$as$u20$anchor_lang..AccountDeserialize$GT$15try_deserialize17h3a768e1b1282fab3E")
    *mayhem_recovered.mayhem_recovered.5873b11261813b4b-cgu.0.rcgu.o(".text._ZN88_$LT$mayhem_recovered..state..MayhemState$u20$as$u20$anchor_lang..AccountDeserialize$GT$25try_deserialize_unchecked17h1686ac7806bb8f2cE")
    *mayhem_recovered.mayhem_recovered.5873b11261813b4b-cgu.0.rcgu.o(".text._ZN147_$LT$mayhem_recovered..state..InitializeMayhemState$u20$as$u20$anchor_lang..Accounts$LT$mayhem_recovered..state..InitializeMayhemStateBumps$GT$$GT$12try_accounts17h4d61772181b0e864E")
    *mayhem_recovered.mayhem_recovered.5873b11261813b4b-cgu.0.rcgu.o(".text._ZN147_$LT$mayhem_recovered..state..InitializeMayhemState$u20$as$u20$anchor_lang..Accounts$LT$mayhem_recovered..state..InitializeMayhemStateBumps$GT$$GT$12try_accounts28_$u7b$$u7b$closure$u7d$$u7d$17h45148e75ad6ffc08E")
    *mayhem_recovered.mayhem_recovered.5873b11261813b4b-cgu.0.rcgu.o(".text._ZN147_$LT$mayhem_recovered..state..InitializeMayhemState$u20$as$u20$anchor_lang..Accounts$LT$mayhem_recovered..state..InitializeMayhemStateBumps$GT$$GT$12try_accounts28_$u7b$$u7b$closure$u7d$$u7d$17h9b4f56d3e8785f60E")
    *mayhem_recovered.mayhem_recovered.5873b11261813b4b-cgu.0.rcgu.o(".text._ZN92_$LT$mayhem_recovered..state..InitializeMayhemState$u20$as$u20$anchor_lang..AccountsExit$GT$4exit17h622f2a890e36aa82E")
    *mayhem_recovered.mayhem_recovered.5873b11261813b4b-cgu.0.rcgu.o(".text._ZN80_$LT$mayhem_recovered..BondingCurve$u20$as$u20$anchor_lang..AccountSerialize$GT$13try_serialize17hffc2e8167d54c592E")
    *mayhem_recovered.mayhem_recovered.5873b11261813b4b-cgu.0.rcgu.o(".text._ZN82_$LT$mayhem_recovered..BondingCurve$u20$as$u20$anchor_lang..AccountDeserialize$GT$15try_deserialize17he11f6ee1c8879b68E")
    *mayhem_recovered.mayhem_recovered.5873b11261813b4b-cgu.0.rcgu.o(".text._ZN82_$LT$mayhem_recovered..BondingCurve$u20$as$u20$anchor_lang..AccountDeserialize$GT$25try_deserialize_unchecked17h1f97d20f0e0a9c96E")
    *mayhem_recovered.mayhem_recovered.5873b11261813b4b-cgu.0.rcgu.o(".text._ZN16mayhem_recovered4pump3cpi3buy17h241ea18944a72d0fE")
    *mayhem_recovered.mayhem_recovered.5873b11261813b4b-cgu.0.rcgu.o(".text._ZN16mayhem_recovered4pump3cpi4sell17hc53d9e69d8ad00faE")
    *mayhem_recovered.mayhem_recovered.5873b11261813b4b-cgu.0.rcgu.o(".text._ZN112_$LT$mayhem_recovered..pump..internal..__cpi_client_accounts_buy..Buy$u20$as$u20$anchor_lang..ToAccountMetas$GT$16to_account_metas17hbbcccd3a7338a243E")
    *mayhem_recovered.mayhem_recovered.5873b11261813b4b-cgu.0.rcgu.o(".text._ZN112_$LT$mayhem_recovered..pump..internal..__cpi_client_accounts_buy..Buy$u20$as$u20$anchor_lang..ToAccountInfos$GT$16to_account_infos17h7de736c0af432723E")
    *mayhem_recovered.mayhem_recovered.5873b11261813b4b-cgu.0.rcgu.o(".text._ZN114_$LT$mayhem_recovered..pump..internal..__cpi_client_accounts_sell..Sell$u20$as$u20$anchor_lang..ToAccountMetas$GT$16to_account_metas17h0a37041a2fc8ec70E")
    *mayhem_recovered.mayhem_recovered.5873b11261813b4b-cgu.0.rcgu.o(".text._ZN114_$LT$mayhem_recovered..pump..internal..__cpi_client_accounts_sell..Sell$u20$as$u20$anchor_lang..ToAccountInfos$GT$16to_account_infos17h4aaec94c7673ef1bE")
    *mayhem_recovered.mayhem_recovered.5873b11261813b4b-cgu.0.rcgu.o(".text._ZN102_$LT$mayhem_recovered..pump_amm..accounts..GlobalConfig$u20$as$u20$anchor_lang..AccountDeserialize$GT$15try_deserialize17h4ae2f5c50e63c0ebE")
    *mayhem_recovered.mayhem_recovered.5873b11261813b4b-cgu.0.rcgu.o(".text._ZN102_$LT$mayhem_recovered..pump_amm..accounts..GlobalConfig$u20$as$u20$anchor_lang..AccountDeserialize$GT$25try_deserialize_unchecked17hf687518f008f096bE")
    *mayhem_recovered.mayhem_recovered.5873b11261813b4b-cgu.0.rcgu.o(".text._ZN16mayhem_recovered7amm_cpi3cpi3buy17h303c9fd7a8abc505E")
    *mayhem_recovered.mayhem_recovered.5873b11261813b4b-cgu.0.rcgu.o(".text._ZN16mayhem_recovered7amm_cpi3cpi4sell17h4e24c58767f49c03E")
    *mayhem_recovered.mayhem_recovered.5873b11261813b4b-cgu.0.rcgu.o(".text._ZN115_$LT$mayhem_recovered..amm_cpi..internal..__cpi_client_accounts_buy..Buy$u20$as$u20$anchor_lang..ToAccountMetas$GT$16to_account_metas17h323b54802c208d83E")
    *mayhem_recovered.mayhem_recovered.5873b11261813b4b-cgu.0.rcgu.o(".text._ZN115_$LT$mayhem_recovered..amm_cpi..internal..__cpi_client_accounts_buy..Buy$u20$as$u20$anchor_lang..ToAccountInfos$GT$16to_account_infos17h8e08b398dd507d9cE")
    *mayhem_recovered.mayhem_recovered.5873b11261813b4b-cgu.0.rcgu.o(".text._ZN117_$LT$mayhem_recovered..amm_cpi..internal..__cpi_client_accounts_sell..Sell$u20$as$u20$anchor_lang..ToAccountMetas$GT$16to_account_metas17hb865a6d72572ae5dE")
    *mayhem_recovered.mayhem_recovered.5873b11261813b4b-cgu.0.rcgu.o(".text._ZN117_$LT$mayhem_recovered..amm_cpi..internal..__cpi_client_accounts_sell..Sell$u20$as$u20$anchor_lang..ToAccountInfos$GT$16to_account_infos17h4c7c6d51bc85d9b3E")
    *mayhem_recovered.mayhem_recovered.5873b11261813b4b-cgu.0.rcgu.o(".text._ZN16mayhem_recovered5entry17hf84ae3fd998b1e39E")
    *mayhem_recovered.mayhem_recovered.5873b11261813b4b-cgu.0.rcgu.o(".text._ZN16mayhem_recovered9__private8__global24initialize_global_params17hae59ba7c542fe874E")
    *mayhem_recovered.mayhem_recovered.5873b11261813b4b-cgu.0.rcgu.o(".text._ZN16mayhem_recovered9__private8__global24initialize_fee_recipient17h7d53bfc6b5231469E")
    *mayhem_recovered.mayhem_recovered.5873b11261813b4b-cgu.0.rcgu.o(".text._ZN16mayhem_recovered9__private8__global10sweep_fees17h2c9466efb7100da7E")
    *mayhem_recovered.mayhem_recovered.5873b11261813b4b-cgu.0.rcgu.o(".text._ZN16mayhem_recovered9__private8__global16sweep_fees_admin17h6b21f52600256e65E")
    *mayhem_recovered.mayhem_recovered.5873b11261813b4b-cgu.0.rcgu.o(".text._ZN16mayhem_recovered9__private8__global24update_max_sol_per_sweep17h5a7417b162120cafE")
    *mayhem_recovered.mayhem_recovered.5873b11261813b4b-cgu.0.rcgu.o(".text._ZN16mayhem_recovered9__private8__global27update_max_stable_per_sweep17hede6dc1e41a873daE")
    *mayhem_recovered.mayhem_recovered.5873b11261813b4b-cgu.0.rcgu.o(".text._ZN16mayhem_recovered9__private8__global14withdraw_admin17h6bb86de521791087E")
    *mayhem_recovered.mayhem_recovered.5873b11261813b4b-cgu.0.rcgu.o(".text._ZN16mayhem_recovered9__private8__global20withdraw_quote_admin17h47a24a44d4ea5dc9E")
    *mayhem_recovered.mayhem_recovered.5873b11261813b4b-cgu.0.rcgu.o(".text._ZN16mayhem_recovered9__private8__global13update_trader17h3ecaeffb5a4fde5bE")
    *mayhem_recovered.mayhem_recovered.5873b11261813b4b-cgu.0.rcgu.o(".text._ZN16mayhem_recovered9__private8__global12update_admin17h43796738df866807E")
    *mayhem_recovered.mayhem_recovered.5873b11261813b4b-cgu.0.rcgu.o(".text._ZN16mayhem_recovered9__private8__global11reset_state17h462e463c3151b77cE")
    *mayhem_recovered.mayhem_recovered.5873b11261813b4b-cgu.0.rcgu.o(".text._ZN16mayhem_recovered9__private8__global18reset_sol_deployed17h06932eefc6b5d319E")
    *mayhem_recovered.mayhem_recovered.5873b11261813b4b-cgu.0.rcgu.o(".text._ZN16mayhem_recovered9__private8__global21reset_stable_deployed17h13fc2d63abc21029E")
    *mayhem_recovered.mayhem_recovered.5873b11261813b4b-cgu.0.rcgu.o(".text._ZN16mayhem_recovered9__private8__global14resume_trading17hda6896f45823f75cE")
    *mayhem_recovered.mayhem_recovered.5873b11261813b4b-cgu.0.rcgu.o(".text._ZN16mayhem_recovered9__private8__global12stop_trading17hcb58ab0cd87e48bbE")
    *mayhem_recovered.mayhem_recovered.5873b11261813b4b-cgu.0.rcgu.o(".text._ZN16mayhem_recovered9__private8__global11burn_tokens17h1adc33e9e043660eE")
    *mayhem_recovered.mayhem_recovered.5873b11261813b4b-cgu.0.rcgu.o(".text._ZN16mayhem_recovered9__private8__global14extend_account17h081d465772787ba9E")
    *mayhem_recovered.mayhem_recovered.5873b11261813b4b-cgu.0.rcgu.o(".text._ZN16mayhem_recovered9__private8__global20update_global_params17h51cc016074bfb814E")
    *mayhem_recovered.mayhem_recovered.5873b11261813b4b-cgu.0.rcgu.o(".text._ZN16mayhem_recovered9__private8__global23initialize_mayhem_state17h56e0dc1655c87c7cE")
    *mayhem_recovered.mayhem_recovered.5873b11261813b4b-cgu.0.rcgu.o(".text._ZN16mayhem_recovered9__private8__global4sell17hc9d94b2bde4ab000E")
    *mayhem_recovered.mayhem_recovered.5873b11261813b4b-cgu.0.rcgu.o(".text._ZN16mayhem_recovered9__private8__global3buy17h139e4ae07363b459E")
    *mayhem_recovered.mayhem_recovered.5873b11261813b4b-cgu.0.rcgu.o(".text._ZN16mayhem_recovered9__private8__global7sell_v217h2a406391c930787dE")
    *mayhem_recovered.mayhem_recovered.5873b11261813b4b-cgu.0.rcgu.o(".text._ZN16mayhem_recovered9__private8__global6buy_v217h4af0a65964598a07E")
    *mayhem_recovered.mayhem_recovered.5873b11261813b4b-cgu.0.rcgu.o(".text._ZN16mayhem_recovered9__private8__global14sell_pump_swap17h2404d5bb4a3255e7E")
    *mayhem_recovered.mayhem_recovered.5873b11261813b4b-cgu.0.rcgu.o(".text._ZN16mayhem_recovered9__private8__global13buy_pump_swap17h7f5f16ebf15f09b1E")
    *mayhem_recovered.mayhem_recovered.5873b11261813b4b-cgu.0.rcgu.o(".text._ZN16mayhem_recovered9__private8__events16__event_dispatch17hc41da51c6519c23bE")
    *mayhem_recovered.mayhem_recovered.5873b11261813b4b-cgu.0.rcgu.o(".text._ZN16mayhem_recovered5state10initialize17h193c953dff480bedE")
    *mayhem_recovered.mayhem_recovered.5873b11261813b4b-cgu.0.rcgu.o(".text.entrypoint")
    *mayhem_recovered.mayhem_recovered.5873b11261813b4b-cgu.0.rcgu.o(".text._RNvCscR3e5J6VSLN_7___rustc12___rust_alloc")
    *mayhem_recovered.mayhem_recovered.5873b11261813b4b-cgu.0.rcgu.o(".text._RNvCscR3e5J6VSLN_7___rustc14___rust_dealloc")
    *mayhem_recovered.mayhem_recovered.5873b11261813b4b-cgu.0.rcgu.o(".text._RNvCscR3e5J6VSLN_7___rustc14___rust_realloc")
    *mayhem_recovered.mayhem_recovered.5873b11261813b4b-cgu.0.rcgu.o(".text._RNvCscR3e5J6VSLN_7___rustc19___rust_alloc_zeroed")
    *mayhem_recovered.mayhem_recovered.5873b11261813b4b-cgu.0.rcgu.o(".text.custom_panic")
    *mayhem_recovered.454kycwv1xv42f6l552bhxgno.rcgu.o(".text._RNvCscR3e5J6VSLN_7___rustc26___rust_alloc_error_handler")
    *mayhem_recovered.454kycwv1xv42f6l552bhxgno.rcgu.o(".text._RNvCscR3e5J6VSLN_7___rustc35___rust_no_alloc_shim_is_unstable_v2")
    *libcurve_accounts-d9bf530c883fa7ac.rlib:curve_accounts-d9bf530c883fa7ac.curve_accounts.55e65f6caa47c3f0-cgu.0.rcgu.o(".text._ZN11anchor_lang5error5Error17with_account_name17h16271ea9b08d6c43E")
    *libcurve_accounts-d9bf530c883fa7ac.rlib:curve_accounts-d9bf530c883fa7ac.curve_accounts.55e65f6caa47c3f0-cgu.0.rcgu.o(".text._ZN4core3fmt5Write9write_fmt17heccc385403ef5a76E")
    *libcurve_accounts-d9bf530c883fa7ac.rlib:curve_accounts-d9bf530c883fa7ac.curve_accounts.55e65f6caa47c3f0-cgu.0.rcgu.o(".text._ZN4core3ptr238drop_in_place$LT$alloc..boxed..convert..$LT$impl$u20$core..convert..From$LT$alloc..string..String$GT$$u20$for$u20$alloc..boxed..Box$LT$dyn$u20$core..error..Error$u2b$core..marker..Sync$u2b$core..marker..Send$GT$$GT$..from..StringError$GT$17h0a541c5c1dcbba2dE")
    *libcurve_accounts-d9bf530c883fa7ac.rlib:curve_accounts-d9bf530c883fa7ac.curve_accounts.55e65f6caa47c3f0-cgu.0.rcgu.o(".text._ZN52_$LT$bool$u20$as$u20$borsh..de..BorshDeserialize$GT$18deserialize_reader17h29f1146674772efbE")
    *libcurve_accounts-d9bf530c883fa7ac.rlib:curve_accounts-d9bf530c883fa7ac.curve_accounts.55e65f6caa47c3f0-cgu.0.rcgu.o(".text._ZN53_$LT$core..fmt..Error$u20$as$u20$core..fmt..Debug$GT$3fmt17haaa5bdc6ce3ebfafE")
    *libcurve_accounts-d9bf530c883fa7ac.rlib:curve_accounts-d9bf530c883fa7ac.curve_accounts.55e65f6caa47c3f0-cgu.0.rcgu.o(".text._ZN58_$LT$alloc..string..String$u20$as$u20$core..fmt..Write$GT$10write_char17h6537f18e3aa683b6E")
    *libcurve_accounts-d9bf530c883fa7ac.rlib:curve_accounts-d9bf530c883fa7ac.curve_accounts.55e65f6caa47c3f0-cgu.0.rcgu.o(".text._ZN58_$LT$alloc..string..String$u20$as$u20$core..fmt..Write$GT$9write_str17hca2d36081997e77fE")
    *libcurve_accounts-d9bf530c883fa7ac.rlib:curve_accounts-d9bf530c883fa7ac.curve_accounts.55e65f6caa47c3f0-cgu.0.rcgu.o(".text.unlikely._ZN5alloc7raw_vec11finish_grow17h3c4322077d308122E")
    *libcurve_accounts-d9bf530c883fa7ac.rlib:curve_accounts-d9bf530c883fa7ac.curve_accounts.55e65f6caa47c3f0-cgu.0.rcgu.o(".text.unlikely._ZN5alloc7raw_vec20RawVecInner$LT$A$GT$7reserve21do_reserve_and_handle17h54a34bcc5ccc7462E")
    *libcurve_accounts-d9bf530c883fa7ac.rlib:curve_accounts-d9bf530c883fa7ac.curve_accounts.55e65f6caa47c3f0-cgu.0.rcgu.o(".text._ZN71_$LT$solana_address..Address$u20$as$u20$borsh..de..BorshDeserialize$GT$18deserialize_reader17h3527c1a493d278f3E")
    *libcurve_accounts-d9bf530c883fa7ac.rlib:curve_accounts-d9bf530c883fa7ac.curve_accounts.55e65f6caa47c3f0-cgu.0.rcgu.o(".text._ZN14curve_accounts21try_deserialize_curve17hde263b51e6da4247E")
    *libcurve_accounts-d9bf530c883fa7ac.rlib:curve_accounts-d9bf530c883fa7ac.curve_accounts.55e65f6caa47c3f0-cgu.0.rcgu.o(".text._ZN80_$LT$curve_accounts..BondingCurve$u20$as$u20$anchor_lang..AccountDeserialize$GT$25try_deserialize_unchecked17h2b16bdbdb535c8dfE")
    *libcurve_accounts-d9bf530c883fa7ac.rlib:curve_accounts-d9bf530c883fa7ac.curve_accounts.55e65f6caa47c3f0-cgu.0.rcgu.o(".text._ZN14curve_accounts13cpi_interface16buy_v2_recovered17h750ccf6773c9e14dE")
    *libcurve_accounts-d9bf530c883fa7ac.rlib:curve_accounts-d9bf530c883fa7ac.curve_accounts.55e65f6caa47c3f0-cgu.0.rcgu.o(".text._ZN14curve_accounts13cpi_interface4pump3cpi7sell_v217h0e169a4d46db0c3eE")
    *libcurve_accounts-d9bf530c883fa7ac.rlib:curve_accounts-d9bf530c883fa7ac.curve_accounts.55e65f6caa47c3f0-cgu.0.rcgu.o(".text._ZN130_$LT$curve_accounts..cpi_interface..pump..internal..__cpi_client_accounts_buy_v2..BuyV2$u20$as$u20$anchor_lang..ToAccountMetas$GT$16to_account_metas17h0d4ac2b5a56a6844E")
    *libcurve_accounts-d9bf530c883fa7ac.rlib:curve_accounts-d9bf530c883fa7ac.curve_accounts.55e65f6caa47c3f0-cgu.0.rcgu.o(".text._ZN130_$LT$curve_accounts..cpi_interface..pump..internal..__cpi_client_accounts_buy_v2..BuyV2$u20$as$u20$anchor_lang..ToAccountInfos$GT$16to_account_infos17h690a286847a5ca5dE")
    *libcurve_accounts-d9bf530c883fa7ac.rlib:curve_accounts-d9bf530c883fa7ac.curve_accounts.55e65f6caa47c3f0-cgu.0.rcgu.o(".text._ZN132_$LT$curve_accounts..cpi_interface..pump..internal..__cpi_client_accounts_sell_v2..SellV2$u20$as$u20$anchor_lang..ToAccountMetas$GT$16to_account_metas17h75fe63fae6ed97acE")
    *libcurve_accounts-d9bf530c883fa7ac.rlib:curve_accounts-d9bf530c883fa7ac.curve_accounts.55e65f6caa47c3f0-cgu.0.rcgu.o(".text._ZN132_$LT$curve_accounts..cpi_interface..pump..internal..__cpi_client_accounts_sell_v2..SellV2$u20$as$u20$anchor_lang..ToAccountInfos$GT$16to_account_infos17h039381cf455d9040E")
    *libcurve_accounts-d9bf530c883fa7ac.rlib:curve_accounts-d9bf530c883fa7ac.curve_accounts.55e65f6caa47c3f0-cgu.0.rcgu.o(".text._ZN14curve_accounts20try_deserialize_pool17h6ce86b37cc26117bE")
    *libcurve_accounts-d9bf530c883fa7ac.rlib:curve_accounts-d9bf530c883fa7ac.curve_accounts.55e65f6caa47c3f0-cgu.0.rcgu.o(".text._ZN72_$LT$curve_accounts..Pool$u20$as$u20$anchor_lang..AccountDeserialize$GT$25try_deserialize_unchecked17hfb4f74ee1f8052cbE")
    *libcurve_accounts-d9bf530c883fa7ac.rlib:curve_accounts-d9bf530c883fa7ac.curve_accounts.55e65f6caa47c3f0-cgu.0.rcgu.o(".text._ZN14curve_accounts13cpi_interface13BuyV2WireArgs9serialize17h0d19cf36e7859532E")
    *libanchor_spl-bb4095c88acacff5.rlib:anchor_spl-bb4095c88acacff5.anchor_spl.6e9c939a2431f196-cgu.0.rcgu.o(".text._ZN4core3ptr74drop_in_place$LT$$u5b$solana_account_info..AccountInfo$u3b$$u20$3$u5d$$GT$17hb29f133505dae50cE")
    *libanchor_spl-bb4095c88acacff5.rlib:anchor_spl-bb4095c88acacff5.anchor_spl.6e9c939a2431f196-cgu.0.rcgu.o(".text._ZN4core3ptr74drop_in_place$LT$$u5b$solana_account_info..AccountInfo$u3b$$u20$6$u5d$$GT$17he080b80ac9b867daE")
    *libanchor_spl-bb4095c88acacff5.rlib:anchor_spl-bb4095c88acacff5.anchor_spl.6e9c939a2431f196-cgu.0.rcgu.o(".text._ZN10anchor_spl16associated_token6create17habab584b42bd791dE")
    *libanchor_spl-bb4095c88acacff5.rlib:anchor_spl-bb4095c88acacff5.anchor_spl.6e9c939a2431f196-cgu.0.rcgu.o(".text._ZN10anchor_spl5token8transfer17hc4f7a6b3c3cb8a41E")
    *libanchor_spl-bb4095c88acacff5.rlib:anchor_spl-bb4095c88acacff5.anchor_spl.6e9c939a2431f196-cgu.0.rcgu.o(".text._ZN10anchor_spl10token_20224burn17h05252e92aa97df8bE")
    *libanchor_spl-bb4095c88acacff5.rlib:anchor_spl-bb4095c88acacff5.anchor_spl.6e9c939a2431f196-cgu.0.rcgu.o(".text._ZN10anchor_spl10token_202213close_account17h2cbabd25d5fc1b9bE")
    *libanchor_spl-bb4095c88acacff5.rlib:anchor_spl-bb4095c88acacff5.anchor_spl.6e9c939a2431f196-cgu.0.rcgu.o(".text._ZN10anchor_spl10token_202211sync_native17h4c0d6caddfbe4e7cE")
    *libanchor_spl-bb4095c88acacff5.rlib:anchor_spl-bb4095c88acacff5.anchor_spl.6e9c939a2431f196-cgu.0.rcgu.o(".text._ZN93_$LT$anchor_spl..token_interface..TokenAccount$u20$as$u20$anchor_lang..AccountDeserialize$GT$25try_deserialize_unchecked17hd9aef022a1976ed0E")
    *libanchor_spl-bb4095c88acacff5.rlib:anchor_spl-bb4095c88acacff5.anchor_spl.6e9c939a2431f196-cgu.0.rcgu.o(".text._ZN85_$LT$anchor_spl..token_interface..Mint$u20$as$u20$anchor_lang..AccountDeserialize$GT$25try_deserialize_unchecked17h0ffb1d9078ccf6c2E")
    *libspl_token_metadata_interface-a915c8b67427f38d.rlib:spl_token_metadata_interface-a915c8b67427f38d.spl_token_metadata_interface.2b455a22f7ec8994-cgu.0.rcgu.o(".text._ZN3std2io5error5Error3new17h79673499aaef8241E")
    *libcurve_accounts-d9bf530c883fa7ac.rlib:curve_accounts-d9bf530c883fa7ac.curve_accounts.55e65f6caa47c3f0-cgu.0.rcgu.o(".text._ZN4core3ptr42drop_in_place$LT$alloc..string..String$GT$17h6ba23bca06a390cfE")
    *libcurve_accounts-d9bf530c883fa7ac.rlib:curve_accounts-d9bf530c883fa7ac.curve_accounts.55e65f6caa47c3f0-cgu.0.rcgu.o(".text._ZN4core5error5Error5cause17hd446e8ffe098be08E")
    *libcurve_accounts-d9bf530c883fa7ac.rlib:curve_accounts-d9bf530c883fa7ac.curve_accounts.55e65f6caa47c3f0-cgu.0.rcgu.o(".text._ZN4core5error5Error7provide17heb24fc47f7b2c92fE")
    *libcurve_accounts-d9bf530c883fa7ac.rlib:curve_accounts-d9bf530c883fa7ac.curve_accounts.55e65f6caa47c3f0-cgu.0.rcgu.o(".text._ZN4core5error5Error7type_id17ha404abc5230933c9E")
    *libspl_token_2022_interface-6130131396c4c5c2.rlib:spl_token_2022_interface-6130131396c4c5c2.spl_token_2022_interface.912155aa0f4230e2-cgu.0.rcgu.o(".text.unlikely._ZN5alloc7raw_vec11finish_grow17h17edbe0f41563d73E")
    *libspl_token_2022_interface-6130131396c4c5c2.rlib:spl_token_2022_interface-6130131396c4c5c2.spl_token_2022_interface.912155aa0f4230e2-cgu.0.rcgu.o(".text.unlikely._ZN5alloc7raw_vec20RawVecInner$LT$A$GT$7reserve21do_reserve_and_handle17ha3ff6a31555fa195E")
    *libspl_token_2022_interface-6130131396c4c5c2.rlib:spl_token_2022_interface-6130131396c4c5c2.spl_token_2022_interface.912155aa0f4230e2-cgu.0.rcgu.o(".text._ZN24spl_token_2022_interface11instruction16TokenInstruction4pack17h859bf421d5f99844E")
    *libspl_token_2022_interface-6130131396c4c5c2.rlib:spl_token_2022_interface-6130131396c4c5c2.spl_token_2022_interface.912155aa0f4230e2-cgu.0.rcgu.o(".text._ZN24spl_token_2022_interface11instruction4burn17h73460c5203b69882E")
    *libspl_token_2022_interface-6130131396c4c5c2.rlib:spl_token_2022_interface-6130131396c4c5c2.spl_token_2022_interface.912155aa0f4230e2-cgu.0.rcgu.o(".text._ZN24spl_token_2022_interface11instruction13close_account17h53e230ad68fc3309E")
    *libspl_token_2022_interface-6130131396c4c5c2.rlib:spl_token_2022_interface-6130131396c4c5c2.spl_token_2022_interface.912155aa0f4230e2-cgu.0.rcgu.o(".text._ZN24spl_token_2022_interface11instruction11sync_native17h58d89e4122091583E")
    *libspl_token_2022_interface-6130131396c4c5c2.rlib:spl_token_2022_interface-6130131396c4c5c2.spl_token_2022_interface.912155aa0f4230e2-cgu.0.rcgu.o(".text._ZN83_$LT$spl_token_2022_interface..state..Mint$u20$as$u20$solana_program_pack..Pack$GT$17unpack_from_slice17h525a4a7c8f29f846E")
    *libspl_token_2022_interface-6130131396c4c5c2.rlib:spl_token_2022_interface-6130131396c4c5c2.spl_token_2022_interface.912155aa0f4230e2-cgu.0.rcgu.o(".text._ZN86_$LT$spl_token_2022_interface..state..Account$u20$as$u20$solana_program_pack..Pack$GT$17unpack_from_slice17he10047adaa527751E")
    *libsolana_stake_interface-88729d7f04c6b0c6.rlib:solana_stake_interface-88729d7f04c6b0c6.solana_stake_interface.333402978180259c-cgu.0.rcgu.o(".text.unlikely._ZN5alloc7raw_vec11finish_grow17h940366e7697cd140E")
    *libsolana_stake_interface-88729d7f04c6b0c6.rlib:solana_stake_interface-88729d7f04c6b0c6.solana_stake_interface.333402978180259c-cgu.0.rcgu.o(".text._ZN5alloc7raw_vec19RawVec$LT$T$C$A$GT$8grow_one17h4c9a6d399ed6a0b7E")
    *libspl_token_interface-a308f8dc9f1303bb.rlib:spl_token_interface-a308f8dc9f1303bb.spl_token_interface.6ff54d6023aeb658-cgu.0.rcgu.o(".text.unlikely._ZN5alloc7raw_vec20RawVecInner$LT$A$GT$7reserve21do_reserve_and_handle17h108781aabe5c19a0E")
    *libspl_token_interface-a308f8dc9f1303bb.rlib:spl_token_interface-a308f8dc9f1303bb.spl_token_interface.6ff54d6023aeb658-cgu.0.rcgu.o(".text._ZN19spl_token_interface11instruction16TokenInstruction4pack17hdfef4310970ae834E")
    *libspl_token_interface-a308f8dc9f1303bb.rlib:spl_token_interface-a308f8dc9f1303bb.spl_token_interface.6ff54d6023aeb658-cgu.0.rcgu.o(".text._ZN19spl_token_interface11instruction8transfer17hd77cb71b301ecef0E")
    *libspl_associated_token_account_interface-68c0323a42ed5034.rlib:spl_associated_token_account_interface-68c0323a42ed5034.spl_associated_token_account_interface.3b2836850a8d22fe-cgu.0.rcgu.o(".text._ZN38spl_associated_token_account_interface7address44get_associated_token_address_with_program_id17h3313f478d3fef283E")
    *libspl_associated_token_account_interface-68c0323a42ed5034.rlib:spl_associated_token_account_interface-68c0323a42ed5034.spl_associated_token_account_interface.3b2836850a8d22fe-cgu.0.rcgu.o(".text._ZN38spl_associated_token_account_interface11instruction42build_associated_token_account_instruction17hab463d45c6db05dbE")
    *libspl_associated_token_account_interface-68c0323a42ed5034.rlib:spl_associated_token_account_interface-68c0323a42ed5034.spl_associated_token_account_interface.3b2836850a8d22fe-cgu.0.rcgu.o(".text._ZN38spl_associated_token_account_interface11instruction31create_associated_token_account17ha5bc9f139f0a932dE")
    *libanchor_lang-e40d4c74e6212529.rlib:anchor_lang-e40d4c74e6212529.anchor_lang.f1dab68826016007-cgu.0.rcgu.o(".text._ZN20solana_program_error95_$LT$impl$u20$core..convert..From$LT$solana_program_error..ProgramError$GT$$u20$for$u20$u64$GT$4from17ha8d6e2f735e6704fE")
    *libanchor_lang-e40d4c74e6212529.rlib:anchor_lang-e40d4c74e6212529.anchor_lang.f1dab68826016007-cgu.0.rcgu.o(".text._ZN42_$LT$$RF$T$u20$as$u20$core..fmt..Debug$GT$3fmt17h10f6bf3cda83653bE")
    *libanchor_lang-e40d4c74e6212529.rlib:anchor_lang-e40d4c74e6212529.anchor_lang.f1dab68826016007-cgu.0.rcgu.o(".text._ZN44_$LT$$RF$T$u20$as$u20$core..fmt..Display$GT$3fmt17h1c0bcabeff7bdde0E")
    *libanchor_lang-e40d4c74e6212529.rlib:anchor_lang-e40d4c74e6212529.anchor_lang.f1dab68826016007-cgu.0.rcgu.o(".text._ZN44_$LT$$RF$T$u20$as$u20$core..fmt..Display$GT$3fmt17h275a17e2b329e5baE")
    *libanchor_lang-e40d4c74e6212529.rlib:anchor_lang-e40d4c74e6212529.anchor_lang.f1dab68826016007-cgu.0.rcgu.o(".text._ZN4core3fmt5Write9write_fmt17ha7e34184288b76f1E")
    *libanchor_lang-e40d4c74e6212529.rlib:anchor_lang-e40d4c74e6212529.anchor_lang.f1dab68826016007-cgu.0.rcgu.o(".text._ZN4core3fmt9Formatter9write_fmt17h3f6b819a15b06d5bE")
    *libspl_token_metadata_interface-a915c8b67427f38d.rlib:spl_token_metadata_interface-a915c8b67427f38d.spl_token_metadata_interface.2b455a22f7ec8994-cgu.0.rcgu.o(".text._ZN4core3ptr238drop_in_place$LT$alloc..boxed..convert..$LT$impl$u20$core..convert..From$LT$alloc..string..String$GT$$u20$for$u20$alloc..boxed..Box$LT$dyn$u20$core..error..Error$u2b$core..marker..Sync$u2b$core..marker..Send$GT$$GT$..from..StringError$GT$17h2dda4cc39ce47de4E")
    *libanchor_lang-e40d4c74e6212529.rlib:anchor_lang-e40d4c74e6212529.anchor_lang.f1dab68826016007-cgu.0.rcgu.o(".text._ZN53_$LT$core..fmt..Error$u20$as$u20$core..fmt..Debug$GT$3fmt17haaa5bdc6ce3ebfafE")
    *libanchor_lang-e40d4c74e6212529.rlib:anchor_lang-e40d4c74e6212529.anchor_lang.f1dab68826016007-cgu.0.rcgu.o(".text._ZN58_$LT$alloc..string..String$u20$as$u20$core..fmt..Write$GT$10write_char17h6537f18e3aa683b6E")
    *libanchor_lang-e40d4c74e6212529.rlib:anchor_lang-e40d4c74e6212529.anchor_lang.f1dab68826016007-cgu.0.rcgu.o(".text._ZN58_$LT$alloc..string..String$u20$as$u20$core..fmt..Write$GT$9write_str17hca2d36081997e77fE")
    *libspl_token_interface-a308f8dc9f1303bb.rlib:spl_token_interface-a308f8dc9f1303bb.spl_token_interface.6ff54d6023aeb658-cgu.0.rcgu.o(".text.unlikely._ZN5alloc7raw_vec11finish_grow17hf779e40fb7f813f5E")
    *libanchor_lang-e40d4c74e6212529.rlib:anchor_lang-e40d4c74e6212529.anchor_lang.f1dab68826016007-cgu.0.rcgu.o(".text.unlikely._ZN5alloc7raw_vec20RawVecInner$LT$A$GT$7reserve21do_reserve_and_handle17h332c390e33ad3227E")
    *libanchor_lang-e40d4c74e6212529.rlib:anchor_lang-e40d4c74e6212529.anchor_lang.f1dab68826016007-cgu.0.rcgu.o(".text._ZN60_$LT$alloc..string..String$u20$as$u20$core..fmt..Display$GT$3fmt17h0abfe8bb398b04f9E")
    *libanchor_lang-e40d4c74e6212529.rlib:anchor_lang-e40d4c74e6212529.anchor_lang.f1dab68826016007-cgu.0.rcgu.o(".text._ZN71_$LT$solana_program_error..ProgramError$u20$as$u20$core..fmt..Debug$GT$3fmt17h6c1b6a595146bf75E")
    *libanchor_lang-e40d4c74e6212529.rlib:anchor_lang-e40d4c74e6212529.anchor_lang.f1dab68826016007-cgu.0.rcgu.o(".text._ZN87_$LT$T$u20$as$u20$alloc..slice..$LT$impl$u20$$u5b$T$u5d$$GT$..to_vec_in..ConvertVec$GT$6to_vec17h52cdf5e52edcaa2aE")
    *libanchor_lang-e40d4c74e6212529.rlib:anchor_lang-e40d4c74e6212529.anchor_lang.f1dab68826016007-cgu.0.rcgu.o(".text._ZN11anchor_lang8accounts12account_info90_$LT$impl$u20$anchor_lang..ToAccountInfos$u20$for$u20$solana_account_info..AccountInfo$GT$16to_account_infos17h5fb5b185e3f2de9bE")
    *libanchor_lang-e40d4c74e6212529.rlib:anchor_lang-e40d4c74e6212529.anchor_lang.f1dab68826016007-cgu.0.rcgu.o(".text._ZN11anchor_lang8accounts6signer6Signer8try_from17h4a6a09a2c8f06a69E")
    *libanchor_lang-e40d4c74e6212529.rlib:anchor_lang-e40d4c74e6212529.anchor_lang.f1dab68826016007-cgu.0.rcgu.o(".text._ZN101_$LT$anchor_lang..bpf_writer..BpfWriter$LT$$RF$mut$u20$$u5b$u8$u5d$$GT$$u20$as$u20$std..io..Write$GT$9write_all17heb44960caaed8f30E")
    *libanchor_lang-e40d4c74e6212529.rlib:anchor_lang-e40d4c74e6212529.anchor_lang.f1dab68826016007-cgu.0.rcgu.o(".text._ZN11anchor_lang6common9is_closed17h7dd700c496b4bc1dE")
    *libanchor_lang-e40d4c74e6212529.rlib:anchor_lang-e40d4c74e6212529.anchor_lang.f1dab68826016007-cgu.0.rcgu.o(".text._ZN104_$LT$anchor_lang..error..Error$u20$as$u20$core..convert..From$LT$anchor_lang..error..AnchorError$GT$$GT$4from17hd9f20696dd98c30bE")
    *libanchor_lang-e40d4c74e6212529.rlib:anchor_lang-e40d4c74e6212529.anchor_lang.f1dab68826016007-cgu.0.rcgu.o(".text._ZN107_$LT$anchor_lang..error..Error$u20$as$u20$core..convert..From$LT$solana_program_error..ProgramError$GT$$GT$4from17hfee23a0a3b9b1035E")
    *libanchor_lang-e40d4c74e6212529.rlib:anchor_lang-e40d4c74e6212529.anchor_lang.f1dab68826016007-cgu.0.rcgu.o(".text._ZN11anchor_lang5error5Error3log17he5d52ccefa0f4a96E")
    *libanchor_lang-e40d4c74e6212529.rlib:anchor_lang-e40d4c74e6212529.anchor_lang.f1dab68826016007-cgu.0.rcgu.o(".text._ZN11anchor_lang5error5Error12with_pubkeys17hb1ad2539761cc251E")
    *libanchor_lang-e40d4c74e6212529.rlib:anchor_lang-e40d4c74e6212529.anchor_lang.f1dab68826016007-cgu.0.rcgu.o(".text._ZN11anchor_lang5error22ProgramErrorWithOrigin3log17h40c5b5c01229e0c5E")
    *libanchor_lang-e40d4c74e6212529.rlib:anchor_lang-e40d4c74e6212529.anchor_lang.f1dab68826016007-cgu.0.rcgu.o(".text._ZN11anchor_lang5error11AnchorError3log17h8fe05bf4cb2f0015E")
    *libanchor_lang-e40d4c74e6212529.rlib:anchor_lang-e40d4c74e6212529.anchor_lang.f1dab68826016007-cgu.0.rcgu.o(".text._ZN11anchor_lang5error117_$LT$impl$u20$core..convert..From$LT$anchor_lang..error..Error$GT$$u20$for$u20$solana_program_error..ProgramError$GT$4from17h9696649fa919ecaeE")
    *libanchor_lang-e40d4c74e6212529.rlib:anchor_lang-e40d4c74e6212529.anchor_lang.f1dab68826016007-cgu.0.rcgu.o(".text._ZN11anchor_lang14system_program8allocate17h36c0608c1f3ad0eeE")
    *libanchor_lang-e40d4c74e6212529.rlib:anchor_lang-e40d4c74e6212529.anchor_lang.f1dab68826016007-cgu.0.rcgu.o(".text._ZN11anchor_lang14system_program6assign17hf5951f069762d7b1E")
    *libanchor_lang-e40d4c74e6212529.rlib:anchor_lang-e40d4c74e6212529.anchor_lang.f1dab68826016007-cgu.0.rcgu.o(".text._ZN11anchor_lang14system_program14create_account17h08a4925b42306532E")
    *libanchor_lang-e40d4c74e6212529.rlib:anchor_lang-e40d4c74e6212529.anchor_lang.f1dab68826016007-cgu.0.rcgu.o(".text._ZN11anchor_lang14system_program8transfer17hb475ab5dafbda9e8E")
    *libanchor_lang-e40d4c74e6212529.rlib:anchor_lang-e40d4c74e6212529.anchor_lang.f1dab68826016007-cgu.0.rcgu.o(".text._ZN11anchor_lang14solana_program3log12sol_log_data17h223987426b4369eeE")
    *libanchor_lang-e40d4c74e6212529.rlib:anchor_lang-e40d4c74e6212529.anchor_lang.f1dab68826016007-cgu.0.rcgu.o(".text._ZN11anchor_lang5error9ErrorCode4name17h4c3be07f7f9c23deE")
    *libanchor_lang-e40d4c74e6212529.rlib:anchor_lang-e40d4c74e6212529.anchor_lang.f1dab68826016007-cgu.0.rcgu.o(".text._ZN102_$LT$anchor_lang..error..Error$u20$as$u20$core..convert..From$LT$anchor_lang..error..ErrorCode$GT$$GT$4from17h70fbd547b2855a35E")
    *libanchor_lang-e40d4c74e6212529.rlib:anchor_lang-e40d4c74e6212529.anchor_lang.f1dab68826016007-cgu.0.rcgu.o(".text._ZN68_$LT$anchor_lang..error..ErrorCode$u20$as$u20$core..fmt..Display$GT$3fmt17hd065e53536ccf55cE")
    *libsolana_instructions_sysvar-9c4094ff215b55c8.rlib:solana_instructions_sysvar-9c4094ff215b55c8.solana_instructions_sysvar.dc50cba303356436-cgu.0.rcgu.o(".text.unlikely._ZN5alloc7raw_vec11finish_grow17h381fd9a2fc480573E")
    *libsolana_instructions_sysvar-9c4094ff215b55c8.rlib:solana_instructions_sysvar-9c4094ff215b55c8.solana_instructions_sysvar.dc50cba303356436-cgu.0.rcgu.o(".text._ZN5alloc7raw_vec19RawVec$LT$T$C$A$GT$8grow_one17h7d631054903b5511E")
    *libsolana_invoke-6f95e183a1727c78.rlib:solana_invoke-6f95e183a1727c78.solana_invoke.dfdcd03744ece765-cgu.0.rcgu.o(".text._ZN13solana_invoke6invoke17h1d28c059f58162e1E")
    *libsolana_invoke-6f95e183a1727c78.rlib:solana_invoke-6f95e183a1727c78.solana_invoke.dfdcd03744ece765-cgu.0.rcgu.o(".text._ZN13solana_invoke13invoke_signed17hdb4001abf6740cbbE")
    *libsolana_system_interface-458f09b56b32cdce.rlib:solana_system_interface-458f09b56b32cdce.solana_system_interface.71ab0bb93b9e7a82-cgu.0.rcgu.o(".text._ZN14solana_address1_80_$LT$impl$u20$serde_core..ser..Serialize$u20$for$u20$solana_address..Address$GT$9serialize17hd3e73d7efaa2243eE")
    *libsolana_system_interface-458f09b56b32cdce.rlib:solana_system_interface-458f09b56b32cdce.solana_system_interface.71ab0bb93b9e7a82-cgu.0.rcgu.o(".text._ZN18solana_instruction11Instruction16new_with_bincode17hb16d5f4440faece4E")
    *libsolana_system_interface-458f09b56b32cdce.rlib:solana_system_interface-458f09b56b32cdce.solana_system_interface.71ab0bb93b9e7a82-cgu.0.rcgu.o(".text._ZN42_$LT$$RF$T$u20$as$u20$core..fmt..Debug$GT$3fmt17ha7998b01ad43f000E")
    *libsolana_system_interface-458f09b56b32cdce.rlib:solana_system_interface-458f09b56b32cdce.solana_system_interface.71ab0bb93b9e7a82-cgu.0.rcgu.o(".text._ZN42_$LT$$RF$T$u20$as$u20$core..fmt..Debug$GT$3fmt17hd36612fcfe7cefb1E")
    *libsolana_system_interface-458f09b56b32cdce.rlib:solana_system_interface-458f09b56b32cdce.solana_system_interface.71ab0bb93b9e7a82-cgu.0.rcgu.o(".text._ZN42_$LT$$RF$T$u20$as$u20$core..fmt..Debug$GT$3fmt17h50c7532cef8a1cc7E")
    *libsolana_system_interface-458f09b56b32cdce.rlib:solana_system_interface-458f09b56b32cdce.solana_system_interface.71ab0bb93b9e7a82-cgu.0.rcgu.o(".text._ZN42_$LT$$RF$T$u20$as$u20$core..fmt..Debug$GT$3fmt17hf9d4af67c7a7fb44E")
    *libsolana_system_interface-458f09b56b32cdce.rlib:solana_system_interface-458f09b56b32cdce.solana_system_interface.71ab0bb93b9e7a82-cgu.0.rcgu.o(".text._ZN42_$LT$$RF$T$u20$as$u20$core..fmt..Debug$GT$3fmt17hac7d66634470c088E")
    *libsolana_system_interface-458f09b56b32cdce.rlib:solana_system_interface-458f09b56b32cdce.solana_system_interface.71ab0bb93b9e7a82-cgu.0.rcgu.o(".text._ZN42_$LT$$RF$T$u20$as$u20$core..fmt..Debug$GT$3fmt17h12a32f248da3517eE")
    *libsolana_system_interface-458f09b56b32cdce.rlib:solana_system_interface-458f09b56b32cdce.solana_system_interface.71ab0bb93b9e7a82-cgu.0.rcgu.o(".text._ZN4core3fmt3num52_$LT$impl$u20$core..fmt..Debug$u20$for$u20$usize$GT$3fmt17hdb1e4730d25472aaE")
    *libsolana_system_interface-458f09b56b32cdce.rlib:solana_system_interface-458f09b56b32cdce.solana_system_interface.71ab0bb93b9e7a82-cgu.0.rcgu.o(".text._ZN4core3ptr71drop_in_place$LT$alloc..boxed..Box$LT$bincode..error..ErrorKind$GT$$GT$17he74da7533bc32238E")
    *libsolana_system_interface-458f09b56b32cdce.rlib:solana_system_interface-458f09b56b32cdce.solana_system_interface.71ab0bb93b9e7a82-cgu.0.rcgu.o(".text.unlikely._ZN5alloc7raw_vec11finish_grow17ha5b7894c7a1fce32E")
    *libsolana_system_interface-458f09b56b32cdce.rlib:solana_system_interface-458f09b56b32cdce.solana_system_interface.71ab0bb93b9e7a82-cgu.0.rcgu.o(".text.unlikely._ZN5alloc7raw_vec20RawVecInner$LT$A$GT$7reserve21do_reserve_and_handle17hcf38e47d9e2432ecE")
    *libsolana_system_interface-458f09b56b32cdce.rlib:solana_system_interface-458f09b56b32cdce.solana_system_interface.71ab0bb93b9e7a82-cgu.0.rcgu.o(".text._ZN67_$LT$alloc..boxed..Box$LT$T$C$A$GT$$u20$as$u20$core..fmt..Debug$GT$3fmt17h380cc98bb1a83274E")
    *libsolana_system_interface-458f09b56b32cdce.rlib:solana_system_interface-458f09b56b32cdce.solana_system_interface.71ab0bb93b9e7a82-cgu.0.rcgu.o(".text._ZN23solana_system_interface11instruction14create_account17h30630444a5695b0bE")
    *libsolana_system_interface-458f09b56b32cdce.rlib:solana_system_interface-458f09b56b32cdce.solana_system_interface.71ab0bb93b9e7a82-cgu.0.rcgu.o(".text._ZN23solana_system_interface11instruction6assign17he3a2e582e774b3b6E")
    *libsolana_system_interface-458f09b56b32cdce.rlib:solana_system_interface-458f09b56b32cdce.solana_system_interface.71ab0bb93b9e7a82-cgu.0.rcgu.o(".text._ZN23solana_system_interface11instruction8transfer17h80708bdb2a8ed837E")
    *libsolana_system_interface-458f09b56b32cdce.rlib:solana_system_interface-458f09b56b32cdce.solana_system_interface.71ab0bb93b9e7a82-cgu.0.rcgu.o(".text._ZN23solana_system_interface11instruction8allocate17hb17ba01df62d6075E")
    *libsolana_sysvar-9deecc9fb9c7b8bf.rlib:solana_sysvar-9deecc9fb9c7b8bf.solana_sysvar.a081fd3bf1d74536-cgu.0.rcgu.o(".text._ZN13solana_sysvar5clock71_$LT$impl$u20$solana_sysvar..Sysvar$u20$for$u20$solana_clock..Clock$GT$3get17h4bfb4153e82302bcE")
    *libsolana_sysvar-9deecc9fb9c7b8bf.rlib:solana_sysvar-9deecc9fb9c7b8bf.solana_sysvar.a081fd3bf1d74536-cgu.0.rcgu.o(".text._ZN13solana_sysvar4rent69_$LT$impl$u20$solana_sysvar..Sysvar$u20$for$u20$solana_rent..Rent$GT$3get17h0c5cc173db3c7cb7E")
    *libsolana_rent-a7589d667235c67e.rlib:solana_rent-a7589d667235c67e.solana_rent.e996550a888ebe45-cgu.0.rcgu.o(".text._ZN11solana_rent4Rent15minimum_balance17he626e40bfed42442E")
    *libsolana_rent-a7589d667235c67e.rlib:solana_rent-a7589d667235c67e.solana_rent.e996550a888ebe45-cgu.0.rcgu.o(".text._ZN11solana_rent4Rent9is_exempt17hd5a83118aebfc397E")
    *libsolana_program_entrypoint-ef334bfa43d4eb53.rlib:solana_program_entrypoint-ef334bfa43d4eb53.solana_program_entrypoint.f381c88f0091cdab-cgu.0.rcgu.o(".text.unlikely._ZN5alloc7raw_vec11finish_grow17h7485876afd994792E")
    *libsolana_program_entrypoint-ef334bfa43d4eb53.rlib:solana_program_entrypoint-ef334bfa43d4eb53.solana_program_entrypoint.f381c88f0091cdab-cgu.0.rcgu.o(".text._ZN5alloc7raw_vec19RawVec$LT$T$C$A$GT$8grow_one17hd1e5703f8bfc5fe1E")
    *libsolana_program_entrypoint-ef334bfa43d4eb53.rlib:solana_program_entrypoint-ef334bfa43d4eb53.solana_program_entrypoint.f381c88f0091cdab-cgu.0.rcgu.o(".text._ZN25solana_program_entrypoint11deserialize17h9f789542de09de8fE")
    *libsolana_account_info-d4e387b23f687b92.rlib:solana_account_info-d4e387b23f687b92.solana_account_info.591c976e8af17f5-cgu.0.rcgu.o(".text._ZN5alloc2rc15Rc$LT$T$C$A$GT$9drop_slow17h74408dd96f5b64b1E")
    *libsolana_account_info-d4e387b23f687b92.rlib:solana_account_info-d4e387b23f687b92.solana_account_info.591c976e8af17f5-cgu.0.rcgu.o(".text._ZN5alloc2rc15Rc$LT$T$C$A$GT$9drop_slow17h0e448c29aa178b27E")
    *libsolana_account_info-d4e387b23f687b92.rlib:solana_account_info-d4e387b23f687b92.solana_account_info.591c976e8af17f5-cgu.0.rcgu.o(".text._ZN19solana_account_info11AccountInfo8lamports17h36ed6b0f7e87f6e0E")
    *libsolana_account_info-d4e387b23f687b92.rlib:solana_account_info-d4e387b23f687b92.solana_account_info.591c976e8af17f5-cgu.0.rcgu.o(".text._ZN19solana_account_info11AccountInfo8data_len17h62d29efe4706a1e0E")
    *libsolana_account_info-d4e387b23f687b92.rlib:solana_account_info-d4e387b23f687b92.solana_account_info.591c976e8af17f5-cgu.0.rcgu.o(".text._ZN19solana_account_info11AccountInfo12try_data_len17h26dd0cc2af6c2e3fE")
    *libsolana_account_info-d4e387b23f687b92.rlib:solana_account_info-d4e387b23f687b92.solana_account_info.591c976e8af17f5-cgu.0.rcgu.o(".text._ZN19solana_account_info11AccountInfo13data_is_empty17hcc9f57c6fdfa964aE")
    *libsolana_account_info-d4e387b23f687b92.rlib:solana_account_info-d4e387b23f687b92.solana_account_info.591c976e8af17f5-cgu.0.rcgu.o(".text._ZN19solana_account_info11AccountInfo6resize17hb7fc2e57fa7957c1E")
    *libsolana_account_info-d4e387b23f687b92.rlib:solana_account_info-d4e387b23f687b92.solana_account_info.591c976e8af17f5-cgu.0.rcgu.o(".text._ZN19solana_account_info11AccountInfo3new17ha8c63b981695b387E")
    *libsolana_instruction-97febfa94ba2110b.rlib:solana_instruction-97febfa94ba2110b.solana_instruction.5e51609c6af3fab9-cgu.0.rcgu.o(".text._ZN18solana_instruction11Instruction14new_with_bytes17h02bcc8c81998f5c7E")
    *libsolana_address-c4b6fa67093b2583.rlib:solana_address-c4b6fa67093b2583.solana_address.5b6ba6fef0ac183a-cgu.0.rcgu.o(".text._ZN14solana_address8syscalls41_$LT$impl$u20$solana_address..Address$GT$3log17h76f136d2c146a1c9E")
    *libsolana_address-c4b6fa67093b2583.rlib:solana_address-c4b6fa67093b2583.solana_address.5b6ba6fef0ac183a-cgu.0.rcgu.o(".text._ZN14solana_address15write_as_base5817h08f3935654efb1b3E")
    *libsolana_address-c4b6fa67093b2583.rlib:solana_address-c4b6fa67093b2583.solana_address.5b6ba6fef0ac183a-cgu.0.rcgu.o(".text._ZN60_$LT$solana_address..Address$u20$as$u20$core..fmt..Debug$GT$3fmt17h9abcfe2882d56ee9E")
    *libsolana_program_error-83969cbe5ffdafaa.rlib:solana_program_error-83969cbe5ffdafaa.solana_program_error.77a8c21d6749471d-cgu.0.rcgu.o(".text._ZN45_$LT$$RF$T$u20$as$u20$core..fmt..LowerHex$GT$3fmt17h62af71d0c27b2cfaE")
    *libsolana_program_error-83969cbe5ffdafaa.rlib:solana_program_error-83969cbe5ffdafaa.solana_program_error.77a8c21d6749471d-cgu.0.rcgu.o(".text._ZN73_$LT$solana_program_error..ProgramError$u20$as$u20$core..fmt..Display$GT$3fmt17h872a086e0732beb6E")
    *libborsh-0f675040a49f1e19.rlib:borsh-0f675040a49f1e19.borsh.dffbb1e563291a07-cgu.0.rcgu.o(".text._ZN5borsh2de44unexpected_eof_to_unexpected_length_of_input17h2b5c9351fa7811caE")
    *libstd-30a182e154ee17f6.rlib:std-30a182e154ee17f6.std.27cd147212409ffc-cgu.0.rcgu.o(".text._ZN42_$LT$$RF$T$u20$as$u20$core..fmt..Debug$GT$3fmt17h26aee6fb7680932bE")
    *libstd-30a182e154ee17f6.rlib:std-30a182e154ee17f6.std.27cd147212409ffc-cgu.0.rcgu.o(".text._ZN42_$LT$$RF$T$u20$as$u20$core..fmt..Debug$GT$3fmt17hda68c1c7f1c5726fE")
    *libstd-30a182e154ee17f6.rlib:std-30a182e154ee17f6.std.27cd147212409ffc-cgu.0.rcgu.o(".text._ZN4core3fmt3num50_$LT$impl$u20$core..fmt..Debug$u20$for$u20$i32$GT$3fmt17hca1ee99b9602d046E")
    *libanchor_lang-e40d4c74e6212529.rlib:anchor_lang-e40d4c74e6212529.anchor_lang.f1dab68826016007-cgu.0.rcgu.o(".text._ZN4core3ptr42drop_in_place$LT$alloc..string..String$GT$17hfacd159ededee9e6E")
    *libstd-30a182e154ee17f6.rlib:std-30a182e154ee17f6.std.27cd147212409ffc-cgu.0.rcgu.o(".text._ZN4core3ptr238drop_in_place$LT$alloc..boxed..convert..$LT$impl$u20$core..convert..From$LT$alloc..string..String$GT$$u20$for$u20$alloc..boxed..Box$LT$dyn$u20$core..error..Error$u2b$core..marker..Sync$u2b$core..marker..Send$GT$$GT$..from..StringError$GT$17h8316abae74cf92b4E")
    *libspl_token_metadata_interface-a915c8b67427f38d.rlib:spl_token_metadata_interface-a915c8b67427f38d.spl_token_metadata_interface.2b455a22f7ec8994-cgu.0.rcgu.o(".text._ZN4core5error5Error5cause17h0a37a7684a76b63aE")
    *libspl_token_metadata_interface-a915c8b67427f38d.rlib:spl_token_metadata_interface-a915c8b67427f38d.spl_token_metadata_interface.2b455a22f7ec8994-cgu.0.rcgu.o(".text._ZN4core5error5Error7provide17hf5f21b0539f0994eE")
    *libspl_token_metadata_interface-a915c8b67427f38d.rlib:spl_token_metadata_interface-a915c8b67427f38d.spl_token_metadata_interface.2b455a22f7ec8994-cgu.0.rcgu.o(".text._ZN4core5error5Error7type_id17ha0259a1763d0d052E")
    *libstd-30a182e154ee17f6.rlib:std-30a182e154ee17f6.std.27cd147212409ffc-cgu.0.rcgu.o(".text._ZN58_$LT$alloc..string..String$u20$as$u20$core..fmt..Debug$GT$3fmt17hf720a149603ffe39E")
    *libstd-30a182e154ee17f6.rlib:std-30a182e154ee17f6.std.27cd147212409ffc-cgu.0.rcgu.o(".text._ZN58_$LT$std..io..error..Error$u20$as$u20$core..fmt..Debug$GT$3fmt17h10f07c55682c7dbdE")
    *libstd-30a182e154ee17f6.rlib:std-30a182e154ee17f6.std.27cd147212409ffc-cgu.0.rcgu.o(".text._ZN3std2io5error5Error3new17h11149d8495b68af6E")
    *libstd-30a182e154ee17f6.rlib:std-30a182e154ee17f6.std.27cd147212409ffc-cgu.0.rcgu.o(".text._ZN3std2io5error5Error4_new17hf437cdaea4dfb409E")
    *libstd-30a182e154ee17f6.rlib:std-30a182e154ee17f6.std.27cd147212409ffc-cgu.0.rcgu.o(".text._ZN3std2io5error83_$LT$impl$u20$core..fmt..Debug$u20$for$u20$std..io..error..repr_bitpacked..Repr$GT$3fmt17h9de5ded71ec5b85cE")
    *libstd-30a182e154ee17f6.rlib:std-30a182e154ee17f6.std.27cd147212409ffc-cgu.0.rcgu.o(".text.unlikely._ZN3std7process5abort17hb785e15ccb55d64fE")
    *libstd-30a182e154ee17f6.rlib:std-30a182e154ee17f6.std.27cd147212409ffc-cgu.0.rcgu.o(".text.unlikely._RNvCscR3e5J6VSLN_7___rustc17rust_begin_unwind")
    *libstd-30a182e154ee17f6.rlib:std-30a182e154ee17f6.std.27cd147212409ffc-cgu.0.rcgu.o(".text._ZN62_$LT$std..io..error..ErrorKind$u20$as$u20$core..fmt..Debug$GT$3fmt17hf18d8e634ec28c8dE")
    *libstd-30a182e154ee17f6.rlib:std-30a182e154ee17f6.std.27cd147212409ffc-cgu.0.rcgu.o(".text._ZN3std3sys3pal3sbf7sol_log17h46ed93fe6cb4860cE")
    *libstd-30a182e154ee17f6.rlib:std-30a182e154ee17f6.std.27cd147212409ffc-cgu.0.rcgu.o(".text.unlikely._ZN3std3sys3pal3sbf5panic17h5e030c92e3e5e13aE")
    *libstd-30a182e154ee17f6.rlib:std-30a182e154ee17f6.std.27cd147212409ffc-cgu.0.rcgu.o(".text.unlikely._ZN3std3sys3pal3sbf14abort_internal17h189f9bb5936a955cE")
    *libstd-30a182e154ee17f6.rlib:std-30a182e154ee17f6.std.27cd147212409ffc-cgu.0.rcgu.o(".text.unlikely._ZN3std5alloc8rust_oom17h1a558e7cdbaf7cc1E")
    *libstd-30a182e154ee17f6.rlib:std-30a182e154ee17f6.std.27cd147212409ffc-cgu.0.rcgu.o(".text.unlikely._RNvCscR3e5J6VSLN_7___rustc8___rg_oom")
    *libhashbrown-49b376391f564566.rlib:hashbrown-49b376391f564566.hashbrown.964eec3a69d8a95e-cgu.0.rcgu.o(".text._ZN9hashbrown3raw11Fallibility17capacity_overflow17ha291a070a3eb228cE")
    *libhashbrown-49b376391f564566.rlib:hashbrown-49b376391f564566.hashbrown.964eec3a69d8a95e-cgu.0.rcgu.o(".text._ZN9hashbrown3raw11Fallibility9alloc_err17he0550021a26b9606E")
    *liballoc-91c82d13bc4939af.rlib:alloc-91c82d13bc4939af.alloc.555e7509368aade7-cgu.0.rcgu.o(".text._ZN4core3fmt5Write9write_fmt17hb93e2ea2789364caE")
    *libstd-30a182e154ee17f6.rlib:std-30a182e154ee17f6.std.27cd147212409ffc-cgu.0.rcgu.o(".text._ZN4core3ptr42drop_in_place$LT$alloc..string..String$GT$17h2cc6d5c97f8ca76fE")
    *liballoc-91c82d13bc4939af.rlib:alloc-91c82d13bc4939af.alloc.555e7509368aade7-cgu.0.rcgu.o(".text._ZN53_$LT$core..fmt..Error$u20$as$u20$core..fmt..Debug$GT$3fmt17haaa5bdc6ce3ebfafE")
    *liballoc-91c82d13bc4939af.rlib:alloc-91c82d13bc4939af.alloc.555e7509368aade7-cgu.0.rcgu.o(".text.unlikely._ZN5alloc7raw_vec17capacity_overflow17hb35234d8fde76484E")
    *liballoc-91c82d13bc4939af.rlib:alloc-91c82d13bc4939af.alloc.555e7509368aade7-cgu.0.rcgu.o(".text.unlikely._ZN5alloc7raw_vec20RawVecInner$LT$A$GT$7reserve21do_reserve_and_handle17h723c6e260acabf7cE")
    *liballoc-91c82d13bc4939af.rlib:alloc-91c82d13bc4939af.alloc.555e7509368aade7-cgu.0.rcgu.o(".text.unlikely._ZN5alloc7raw_vec11finish_grow17h726e8a9d8127cc67E")
    *liballoc-91c82d13bc4939af.rlib:alloc-91c82d13bc4939af.alloc.555e7509368aade7-cgu.0.rcgu.o(".text.unlikely._ZN5alloc7raw_vec12handle_error17h49931f096d3db69aE")
    *liballoc-91c82d13bc4939af.rlib:alloc-91c82d13bc4939af.alloc.555e7509368aade7-cgu.0.rcgu.o(".text.unlikely._ZN5alloc5alloc18handle_alloc_error17hdecd2d8ca4c9b5bbE")
    *liballoc-91c82d13bc4939af.rlib:alloc-91c82d13bc4939af.alloc.555e7509368aade7-cgu.0.rcgu.o(".text._ZN256_$LT$alloc..boxed..convert..$LT$impl$u20$core..convert..From$LT$alloc..string..String$GT$$u20$for$u20$alloc..boxed..Box$LT$dyn$u20$core..error..Error$u2b$core..marker..Sync$u2b$core..marker..Send$GT$$GT$..from..StringError$u20$as$u20$core..error..Error$GT$11description17h4f1e64f34513d1a7E")
    *liballoc-91c82d13bc4939af.rlib:alloc-91c82d13bc4939af.alloc.555e7509368aade7-cgu.0.rcgu.o(".text._ZN256_$LT$alloc..boxed..convert..$LT$impl$u20$core..convert..From$LT$alloc..string..String$GT$$u20$for$u20$alloc..boxed..Box$LT$dyn$u20$core..error..Error$u2b$core..marker..Sync$u2b$core..marker..Send$GT$$GT$..from..StringError$u20$as$u20$core..fmt..Display$GT$3fmt17hb11f259b86c7ce07E")
    *liballoc-91c82d13bc4939af.rlib:alloc-91c82d13bc4939af.alloc.555e7509368aade7-cgu.0.rcgu.o(".text._ZN254_$LT$alloc..boxed..convert..$LT$impl$u20$core..convert..From$LT$alloc..string..String$GT$$u20$for$u20$alloc..boxed..Box$LT$dyn$u20$core..error..Error$u2b$core..marker..Sync$u2b$core..marker..Send$GT$$GT$..from..StringError$u20$as$u20$core..fmt..Debug$GT$3fmt17hc16cdd4affb20139E")
    *liballoc-91c82d13bc4939af.rlib:alloc-91c82d13bc4939af.alloc.555e7509368aade7-cgu.0.rcgu.o(".text._ZN5alloc3fmt6format12format_inner17h36b493547a55b45dE")
    *liballoc-91c82d13bc4939af.rlib:alloc-91c82d13bc4939af.alloc.555e7509368aade7-cgu.0.rcgu.o(".text._ZN58_$LT$alloc..string..String$u20$as$u20$core..fmt..Write$GT$9write_str17hca2d36081997e77fE")
    *liballoc-91c82d13bc4939af.rlib:alloc-91c82d13bc4939af.alloc.555e7509368aade7-cgu.0.rcgu.o(".text._ZN58_$LT$alloc..string..String$u20$as$u20$core..fmt..Write$GT$10write_char17h6537f18e3aa683b6E")
    *libcore-673053c840437f62.rlib:core-673053c840437f62.core.e65e0c7e339ea620-cgu.0.rcgu.o(".text._ZN71_$LT$core..ops..range..Range$LT$Idx$GT$$u20$as$u20$core..fmt..Debug$GT$3fmt17hc74cdea0260d66aeE")
    *libcore-673053c840437f62.rlib:core-673053c840437f62.core.e65e0c7e339ea620-cgu.0.rcgu.o(".text._ZN62_$LT$core..cell..BorrowError$u20$as$u20$core..fmt..Display$GT$3fmt17h3a77ba6c4ee4b0aaE")
    *libcore-673053c840437f62.rlib:core-673053c840437f62.core.e65e0c7e339ea620-cgu.0.rcgu.o(".text.unlikely._ZN4core4cell30panic_already_mutably_borrowed17h3f8a590091336958E")
    *libcore-673053c840437f62.rlib:core-673053c840437f62.core.e65e0c7e339ea620-cgu.0.rcgu.o(".text._ZN4core4char7methods22_$LT$impl$u20$char$GT$16escape_debug_ext17h8e39e5bdc678cbf9E")
    *libcore-673053c840437f62.rlib:core-673053c840437f62.core.e65e0c7e339ea620-cgu.0.rcgu.o(".text.unlikely._ZN4core6option13unwrap_failed17h2d9b86860954c5aeE")
    *libcore-673053c840437f62.rlib:core-673053c840437f62.core.e65e0c7e339ea620-cgu.0.rcgu.o(".text.unlikely._ZN4core9panicking9panic_fmt17hd057c6f753903b3bE")
    *libcore-673053c840437f62.rlib:core-673053c840437f62.core.e65e0c7e339ea620-cgu.0.rcgu.o(".text.unlikely._ZN4core9panicking5panic17h9e86d515c1725fb5E")
    *libcore-673053c840437f62.rlib:core-673053c840437f62.core.e65e0c7e339ea620-cgu.0.rcgu.o(".text.unlikely._ZN4core9panicking18panic_bounds_check17hf0c02a9253951be5E")
    *libcore-673053c840437f62.rlib:core-673053c840437f62.core.e65e0c7e339ea620-cgu.0.rcgu.o(".text.unlikely._ZN4core6result13unwrap_failed17h5a0595231043dbf9E")
    *libcore-673053c840437f62.rlib:core-673053c840437f62.core.e65e0c7e339ea620-cgu.0.rcgu.o(".text._ZN68_$LT$core..fmt..builders..PadAdapter$u20$as$u20$core..fmt..Write$GT$9write_str17h07b1cfaa048142fbE")
    *libcore-673053c840437f62.rlib:core-673053c840437f62.core.e65e0c7e339ea620-cgu.0.rcgu.o(".text._ZN68_$LT$core..fmt..builders..PadAdapter$u20$as$u20$core..fmt..Write$GT$10write_char17he754e8861ee9982cE")
    *libcore-673053c840437f62.rlib:core-673053c840437f62.core.e65e0c7e339ea620-cgu.0.rcgu.o(".text._ZN4core3fmt8builders11DebugStruct5field17h7c3cf5643de20b65E")
    *libcore-673053c840437f62.rlib:core-673053c840437f62.core.e65e0c7e339ea620-cgu.0.rcgu.o(".text._ZN4core3fmt8builders11DebugStruct6finish17h4efe41d9b850ea80E")
    *libcore-673053c840437f62.rlib:core-673053c840437f62.core.e65e0c7e339ea620-cgu.0.rcgu.o(".text._ZN4core3fmt8builders10DebugTuple5field17h07f284e029b65ac5E")
    *libcore-673053c840437f62.rlib:core-673053c840437f62.core.e65e0c7e339ea620-cgu.0.rcgu.o(".text._ZN4core3fmt8builders10DebugTuple6finish17h20638c02b3cc7b82E")
    *libcore-673053c840437f62.rlib:core-673053c840437f62.core.e65e0c7e339ea620-cgu.0.rcgu.o(".text._ZN4core3fmt5Write9write_fmt17h085a20d0e6cb78c5E")
    *libcore-673053c840437f62.rlib:core-673053c840437f62.core.e65e0c7e339ea620-cgu.0.rcgu.o(".text._ZN4core3fmt5write17h6598dd1fd9735818E")
    *libcore-673053c840437f62.rlib:core-673053c840437f62.core.e65e0c7e339ea620-cgu.0.rcgu.o(".text._ZN4core3fmt9Formatter12pad_integral17h5db7dcc7186aa7b9E")
    *libcore-673053c840437f62.rlib:core-673053c840437f62.core.e65e0c7e339ea620-cgu.0.rcgu.o(".text._ZN4core3fmt9Formatter12pad_integral12write_prefix17h8540d140f3ea9e8aE")
    *libcore-673053c840437f62.rlib:core-673053c840437f62.core.e65e0c7e339ea620-cgu.0.rcgu.o(".text._ZN4core3fmt9Formatter3pad17h9fe7d713aebd4bf2E")
    *libcore-673053c840437f62.rlib:core-673053c840437f62.core.e65e0c7e339ea620-cgu.0.rcgu.o(".text._ZN4core3fmt9Formatter9write_str17h969f1c036f9c0313E")
    *libcore-673053c840437f62.rlib:core-673053c840437f62.core.e65e0c7e339ea620-cgu.0.rcgu.o(".text._ZN4core3fmt9Formatter12debug_struct17h3703beb303cfa4c5E")
    *libcore-673053c840437f62.rlib:core-673053c840437f62.core.e65e0c7e339ea620-cgu.0.rcgu.o(".text._ZN4core3fmt9Formatter26debug_struct_field2_finish17h115cad4bd41b5c4dE")
    *libcore-673053c840437f62.rlib:core-673053c840437f62.core.e65e0c7e339ea620-cgu.0.rcgu.o(".text._ZN4core3fmt9Formatter11debug_tuple17h92a3ad57be6ee082E")
    *libcore-673053c840437f62.rlib:core-673053c840437f62.core.e65e0c7e339ea620-cgu.0.rcgu.o(".text._ZN4core3fmt9Formatter25debug_tuple_field1_finish17ha04ac01d5860eb24E")
    *libcore-673053c840437f62.rlib:core-673053c840437f62.core.e65e0c7e339ea620-cgu.0.rcgu.o(".text._ZN40_$LT$str$u20$as$u20$core..fmt..Debug$GT$3fmt17h90c958a145934ae7E")
    *libcore-673053c840437f62.rlib:core-673053c840437f62.core.e65e0c7e339ea620-cgu.0.rcgu.o(".text._ZN42_$LT$str$u20$as$u20$core..fmt..Display$GT$3fmt17haf5cf6b179ff776eE")
    *libcore-673053c840437f62.rlib:core-673053c840437f62.core.e65e0c7e339ea620-cgu.0.rcgu.o(".text._ZN41_$LT$char$u20$as$u20$core..fmt..Debug$GT$3fmt17h085a8c0784802dc0E")
    *libcore-673053c840437f62.rlib:core-673053c840437f62.core.e65e0c7e339ea620-cgu.0.rcgu.o(".text.unlikely._ZN4core5slice5index26slice_start_index_len_fail17h67830a8602ab6cd3E")
    *libcore-673053c840437f62.rlib:core-673053c840437f62.core.e65e0c7e339ea620-cgu.0.rcgu.o(".text.unlikely._ZN4core5slice5index24slice_end_index_len_fail17h1f4e9e019b5e2314E")
    *libcore-673053c840437f62.rlib:core-673053c840437f62.core.e65e0c7e339ea620-cgu.0.rcgu.o(".text.unlikely._ZN4core5slice5index22slice_index_order_fail17h80817da18ae50333E")
    *libcore-673053c840437f62.rlib:core-673053c840437f62.core.e65e0c7e339ea620-cgu.0.rcgu.o(".text._ZN4core3str5count14do_count_chars17h5edf8ed4356233f2E")
    *libcore-673053c840437f62.rlib:core-673053c840437f62.core.e65e0c7e339ea620-cgu.0.rcgu.o(".text.unlikely._ZN4core3str16slice_error_fail17h758cfb41ee03f598E")
    *libcore-673053c840437f62.rlib:core-673053c840437f62.core.e65e0c7e339ea620-cgu.0.rcgu.o(".text._ZN4core3str19slice_error_fail_rt17hc7045508a0dabd71E")
    *libcore-673053c840437f62.rlib:core-673053c840437f62.core.e65e0c7e339ea620-cgu.0.rcgu.o(".text._ZN4core7unicode9printable5check17h23d5580a309014c9E")
    *libcore-673053c840437f62.rlib:core-673053c840437f62.core.e65e0c7e339ea620-cgu.0.rcgu.o(".text._ZN4core7unicode9printable12is_printable17h77c2525936026c86E")
    *libcore-673053c840437f62.rlib:core-673053c840437f62.core.e65e0c7e339ea620-cgu.0.rcgu.o(".text.unlikely._ZN4core9panicking11panic_const24panic_const_add_overflow17h3493e0c6194f31d7E")
    *libcore-673053c840437f62.rlib:core-673053c840437f62.core.e65e0c7e339ea620-cgu.0.rcgu.o(".text.unlikely._ZN4core9panicking11panic_const24panic_const_sub_overflow17h73105958df4c0d1cE")
    *libcore-673053c840437f62.rlib:core-673053c840437f62.core.e65e0c7e339ea620-cgu.0.rcgu.o(".text.unlikely._ZN4core9panicking11panic_const24panic_const_mul_overflow17h7c8001528ea4174dE")
    *libcore-673053c840437f62.rlib:core-673053c840437f62.core.e65e0c7e339ea620-cgu.0.rcgu.o(".text._ZN4core3fmt3num52_$LT$impl$u20$core..fmt..LowerHex$u20$for$u20$i8$GT$3fmt17haa6262e9f1b514dfE")
    *libcore-673053c840437f62.rlib:core-673053c840437f62.core.e65e0c7e339ea620-cgu.0.rcgu.o(".text._ZN4core3fmt3num52_$LT$impl$u20$core..fmt..UpperHex$u20$for$u20$i8$GT$3fmt17h865719d394404866E")
    *libcore-673053c840437f62.rlib:core-673053c840437f62.core.e65e0c7e339ea620-cgu.0.rcgu.o(".text._ZN4core3fmt3num53_$LT$impl$u20$core..fmt..LowerHex$u20$for$u20$i32$GT$3fmt17hd6b591b3de4bff16E")
    *libcore-673053c840437f62.rlib:core-673053c840437f62.core.e65e0c7e339ea620-cgu.0.rcgu.o(".text._ZN4core3fmt3num53_$LT$impl$u20$core..fmt..UpperHex$u20$for$u20$i32$GT$3fmt17h26f1f2b9a04d48abE")
    *libcore-673053c840437f62.rlib:core-673053c840437f62.core.e65e0c7e339ea620-cgu.0.rcgu.o(".text._ZN4core3fmt3num53_$LT$impl$u20$core..fmt..LowerHex$u20$for$u20$i64$GT$3fmt17h152865ae223db4b8E")
    *libcore-673053c840437f62.rlib:core-673053c840437f62.core.e65e0c7e339ea620-cgu.0.rcgu.o(".text._ZN4core3fmt3num53_$LT$impl$u20$core..fmt..UpperHex$u20$for$u20$i64$GT$3fmt17hbb1080c240f8d273E")
    *libcore-673053c840437f62.rlib:core-673053c840437f62.core.e65e0c7e339ea620-cgu.0.rcgu.o(".text._ZN4core3fmt3num52_$LT$impl$u20$core..fmt..Debug$u20$for$u20$usize$GT$3fmt17hdb1e4730d25472aaE")
    *libcore-673053c840437f62.rlib:core-673053c840437f62.core.e65e0c7e339ea620-cgu.0.rcgu.o(".text._ZN4core3fmt3num3imp51_$LT$impl$u20$core..fmt..Display$u20$for$u20$u8$GT$3fmt17h54c5bebdfae9905eE")
    *libcore-673053c840437f62.rlib:core-673053c840437f62.core.e65e0c7e339ea620-cgu.0.rcgu.o(".text._ZN4core3fmt3num3imp20_$LT$impl$u20$u8$GT$4_fmt17hb959e6e97e52f102E")
    *libcore-673053c840437f62.rlib:core-673053c840437f62.core.e65e0c7e339ea620-cgu.0.rcgu.o(".text._ZN4core3fmt3num3imp52_$LT$impl$u20$core..fmt..Display$u20$for$u20$u32$GT$3fmt17h4914e23be7844e54E")
    *libcore-673053c840437f62.rlib:core-673053c840437f62.core.e65e0c7e339ea620-cgu.0.rcgu.o(".text._ZN4core3fmt3num3imp52_$LT$impl$u20$core..fmt..Display$u20$for$u20$i32$GT$3fmt17h6111f563f46b6dc2E")
    *libcore-673053c840437f62.rlib:core-673053c840437f62.core.e65e0c7e339ea620-cgu.0.rcgu.o(".text._ZN4core3fmt3num3imp21_$LT$impl$u20$u32$GT$4_fmt17h92f5710b9e1a67e8E")
    *libcore-673053c840437f62.rlib:core-673053c840437f62.core.e65e0c7e339ea620-cgu.0.rcgu.o(".text._ZN4core3fmt3num3imp52_$LT$impl$u20$core..fmt..Display$u20$for$u20$u64$GT$3fmt17hb4b04baeaa01359fE")
    *libcore-673053c840437f62.rlib:core-673053c840437f62.core.e65e0c7e339ea620-cgu.0.rcgu.o(".text._ZN4core3fmt3num3imp21_$LT$impl$u20$u64$GT$4_fmt17h25fce7c7a9cb3ccfE")
    *libcore-673053c840437f62.rlib:core-673053c840437f62.core.e65e0c7e339ea620-cgu.0.rcgu.o(".text._ZN42_$LT$$RF$T$u20$as$u20$core..fmt..Debug$GT$3fmt17h0c058cd771a6cfd7E")
    *libcore-673053c840437f62.rlib:core-673053c840437f62.core.e65e0c7e339ea620-cgu.0.rcgu.o(".text._ZN44_$LT$$RF$T$u20$as$u20$core..fmt..Display$GT$3fmt17hf98bacc17f6ab5f4E")
    *libcore-673053c840437f62.rlib:core-673053c840437f62.core.e65e0c7e339ea620-cgu.0.rcgu.o(".text.unlikely._ZN4core5slice5index26slice_start_index_len_fail8do_panic7runtime17hbfc67de29d3cd273E")
    *libcore-673053c840437f62.rlib:core-673053c840437f62.core.e65e0c7e339ea620-cgu.0.rcgu.o(".text.unlikely._ZN4core5slice5index24slice_end_index_len_fail8do_panic7runtime17h2c6c50df44ce9817E")
    *libcore-673053c840437f62.rlib:core-673053c840437f62.core.e65e0c7e339ea620-cgu.0.rcgu.o(".text.unlikely._ZN4core5slice5index22slice_index_order_fail8do_panic7runtime17hab9d550cdf90aa9cE")
    *libcore-673053c840437f62.rlib:core-673053c840437f62.core.e65e0c7e339ea620-cgu.0.rcgu.o(".text._ZN4core7unicode12unicode_data15grapheme_extend11lookup_slow17h3de7df68a4b16d65E")
    *libcompiler_builtins-3449fbafc948693e.rlib:compiler_builtins-3449fbafc948693e.compiler_builtins.6ccb59b2cefd2cdd-cgu.114.rcgu.o(".text.memcpy")
    *libcompiler_builtins-3449fbafc948693e.rlib:compiler_builtins-3449fbafc948693e.compiler_builtins.6ccb59b2cefd2cdd-cgu.114.rcgu.o(".text.memmove")
    *libcompiler_builtins-3449fbafc948693e.rlib:compiler_builtins-3449fbafc948693e.compiler_builtins.6ccb59b2cefd2cdd-cgu.114.rcgu.o(".text.memset")
    *libcompiler_builtins-3449fbafc948693e.rlib:compiler_builtins-3449fbafc948693e.compiler_builtins.6ccb59b2cefd2cdd-cgu.114.rcgu.o(".text.memcmp")
    *libcompiler_builtins-3449fbafc948693e.rlib:compiler_builtins-3449fbafc948693e.compiler_builtins.6ccb59b2cefd2cdd-cgu.148.rcgu.o(".text.__udivti3")
    *libcompiler_builtins-3449fbafc948693e.rlib:compiler_builtins-3449fbafc948693e.compiler_builtins.6ccb59b2cefd2cdd-cgu.012.rcgu.o(".text._ZN17compiler_builtins3int19specialized_div_rem12u128_div_rem17h79f8b203ef37c50bE")
    *libcompiler_builtins-3449fbafc948693e.rlib:compiler_builtins-3449fbafc948693e.compiler_builtins.6ccb59b2cefd2cdd-cgu.153.rcgu.o(".text.__floatundidf")
    *libcompiler_builtins-3449fbafc948693e.rlib:compiler_builtins-3449fbafc948693e.compiler_builtins.6ccb59b2cefd2cdd-cgu.158.rcgu.o(".text.__gedf2")
    *libcompiler_builtins-3449fbafc948693e.rlib:compiler_builtins-3449fbafc948693e.compiler_builtins.6ccb59b2cefd2cdd-cgu.172.rcgu.o(".text.__muldf3")
    *libcompiler_builtins-3449fbafc948693e.rlib:compiler_builtins-3449fbafc948693e.compiler_builtins.6ccb59b2cefd2cdd-cgu.004.rcgu.o(".text._ZN17compiler_builtins5float3mul8__muldf317h541a3f2bd4b92bbdE")
    *libcompiler_builtins-3449fbafc948693e.rlib:compiler_builtins-3449fbafc948693e.compiler_builtins.6ccb59b2cefd2cdd-cgu.228.rcgu.o(".text.__fixunsdfdi")
    *libcompiler_builtins-3449fbafc948693e.rlib:compiler_builtins-3449fbafc948693e.compiler_builtins.6ccb59b2cefd2cdd-cgu.244.rcgu.o(".text.__ashlti3")
    *libcompiler_builtins-3449fbafc948693e.rlib:compiler_builtins-3449fbafc948693e.compiler_builtins.6ccb59b2cefd2cdd-cgu.269.rcgu.o(".text.__lshrti3")
    *libcompiler_builtins-3449fbafc948693e.rlib:compiler_builtins-3449fbafc948693e.compiler_builtins.6ccb59b2cefd2cdd-cgu.304.rcgu.o(".text.__multi3")
    *libcompiler_builtins-3449fbafc948693e.rlib:compiler_builtins-3449fbafc948693e.compiler_builtins.6ccb59b2cefd2cdd-cgu.315.rcgu.o(".text.__gtdf2")
    *mayhem_recovered.mayhem_recovered.5873b11261813b4b-cgu.0.rcgu.o(".text._ZN49_$LT$T$u20$as$u20$alloc..string..SpecToString$GT$14spec_to_string17h5d92bd1dbb15d7abE")
    *mayhem_recovered.mayhem_recovered.5873b11261813b4b-cgu.0.rcgu.o(".text._ZN4core3ptr85drop_in_place$LT$core..result..Result$LT$$LP$$RP$$C$anchor_lang..error..Error$GT$$GT$17hfca78cd63ed171b2E")
    *mayhem_recovered.mayhem_recovered.5873b11261813b4b-cgu.0.rcgu.o(".text._ZN16mayhem_recovered5state12sell_amounts17h92ae24043e960e4aE")
    *mayhem_recovered.mayhem_recovered.5873b11261813b4b-cgu.0.rcgu.o(".text._ZN16mayhem_recovered12instructions13buy_pump_swap4math17hf8caabb8494b44e9E")
    *mayhem_recovered.mayhem_recovered.5873b11261813b4b-cgu.0.rcgu.o(".text._ZN16mayhem_recovered12instructions18pump_amm_interface14bought_amounts17h1225bdf40509c39fE")
    *mayhem_recovered.mayhem_recovered.5873b11261813b4b-cgu.0.rcgu.o(".text._ZN16mayhem_recovered15sweep_remaining17hd0a3fd94bfe1f328E")
    *mayhem_recovered.mayhem_recovered.5873b11261813b4b-cgu.0.rcgu.o(".text._ZN16mayhem_recovered112_$LT$impl$u20$core..convert..From$LT$mayhem_recovered..MayhemError$GT$$u20$for$u20$anchor_lang..error..Error$GT$4from17hfe4fcdc7829771bbE")
    *libcurve_accounts-d9bf530c883fa7ac.rlib:curve_accounts-d9bf530c883fa7ac.curve_accounts.55e65f6caa47c3f0-cgu.0.rcgu.o(".text._ZN3std2io5error5Error3new17hda97c263e0389a69E")
    *libspl_token_interface-a308f8dc9f1303bb.rlib:spl_token_interface-a308f8dc9f1303bb.spl_token_interface.6ff54d6023aeb658-cgu.0.rcgu.o(".text._ZN5alloc7raw_vec19RawVec$LT$T$C$A$GT$8grow_one17h5debf5d68acb635dE")
    *libanchor_lang-e40d4c74e6212529.rlib:anchor_lang-e40d4c74e6212529.anchor_lang.f1dab68826016007-cgu.0.rcgu.o(".text.unlikely._ZN5alloc7raw_vec11finish_grow17h585e6f233051955cE")
    *libstd-30a182e154ee17f6.rlib:std-30a182e154ee17f6.std.27cd147212409ffc-cgu.0.rcgu.o(".text._ZN4core5error5Error5cause17hb0eb8cc32d3b0cc7E")
    *libstd-30a182e154ee17f6.rlib:std-30a182e154ee17f6.std.27cd147212409ffc-cgu.0.rcgu.o(".text._ZN4core5error5Error7provide17h80575cc6999f5459E")
    *libstd-30a182e154ee17f6.rlib:std-30a182e154ee17f6.std.27cd147212409ffc-cgu.0.rcgu.o(".text._ZN4core5error5Error7type_id17h9b5908a8d5c815c6E")
    *liballoc-91c82d13bc4939af.rlib:alloc-91c82d13bc4939af.alloc.555e7509368aade7-cgu.0.rcgu.o(".text._ZN4core3ptr42drop_in_place$LT$alloc..string..String$GT$17h6cc142a95ab821b1E")
    *libcore-673053c840437f62.rlib:core-673053c840437f62.core.e65e0c7e339ea620-cgu.0.rcgu.o(".text.unlikely._ZN4core9panicking11panic_const23panic_const_div_by_zero17h79d407179eb3033fE")
    *(.text*)
  } :text
  .rodata : { *(.rodata*) } :rodata
  .data.rel.ro : { *(.data.rel.ro*) } :rodata
  .dynamic : { *(.dynamic) } :dynamic
  .dynsym : { *(.dynsym) } :data
  .dynstr : { *(.dynstr) } :data
  .rel.dyn : { *(.rel.dyn) } :data
  /DISCARD/ : {
      *(.eh_frame*)
      *(.gnu.hash*)
      *(.hash*)
    }
}
